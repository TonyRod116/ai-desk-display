// AI Desk Display: shows pages pushed by the PC and changes page on touch.
//
// The PC (token-tv) renders every page as exact RGB565 pixels, so this board
// needs no decoder, no accounts, no credentials and no internet. It accepts
// pages only from callers that know a token it generated and shows on its own
// screen (long-press to see it again). It never asks the PC for anything. If
// nothing arrives for three minutes it blanks the numbers, like the clock
// faces do for expired readings.
//
// Pairing: the PC chooses the token. A board without one lets the first caller claim it
// (POST /pair), so reflashing or formatting never needs anything typed. Holding the screen
// for 5 seconds and releasing opens the connection screen. Updates need the token AND the
// address screen on display, i.e. someone touching the board.
//
// Frame file: "TVF1" + width (u16 LE) + height (u16 LE) + width*height RGB565 (LE).
// A frame smaller than the screen is centred on black.
#include <Arduino.h>
#include <FS.h>
#include <LittleFS.h>
#include <Preferences.h>
#include <SPI.h>
#include <TFT_eSPI.h>
#include <Update.h>
#include <WebServer.h>
#include <WiFi.h>
#include <WiFiManager.h>
#include <XPT2046_Touchscreen.h>
#include <esp_system.h>
#include <lwip/sockets.h>
#include <errno.h>

#include "rotation.h"
#include "animation_clock.h"
#include "splash_data.h"   // generated by tools/make_splash.py

static const char *FIRMWARE = "ai-desk-display 39";   // keep the wave moving during transfers
static const int PAGES = 8;
static const size_t MAX_PAGE_BYTES = 8 + 320 * 240 * 2 + 81920;  // pixels and an optional star or animation trailer
static const unsigned long STALE_MS = 180000UL;   // same expiry as the quota readings
static RotationClock rotationClock;
static AnimationClock animationClock;
static int pageSpeeds[PAGES] = {100,100,100,100,100,100,100,100};
static int modeHoldSeconds = 2, connectHoldSeconds = 5;
static uint32_t confirmationUntil = 0;
static bool touchHeld = false;
static uint32_t heldSince = 0;
static int savedPage = -1;
static const unsigned long TAP_DEBOUNCE_MS = 300UL;
static const int BAND_ROWS = 8;

TFT_eSPI tft;
// No IRQ pin on purpose: the library then reads the panel's pressure on every poll. With the pin it only looks
// after a falling edge on that line, and one lost edge (or a line stuck low) leaves the touch deaf while
// everything else keeps working. Firmware 6 polls every 10 ms instead.
XPT2046_Touchscreen touch(TOUCH_CS_PIN);
static unsigned long tapCount = 0, longCount = 0;   // shown by /info, to tell a dead panel from a lost tap
WebServer server(80);
Preferences prefs;

String token;
int rotation = 1;      // 1 or 3: landscape, either way up
#ifndef TOKENTV_INVERT_DEFAULT
#define TOKENTV_INVERT_DEFAULT 1   // this panel family shows a photographic negative without it
#endif
bool invertColors = TOKENTV_INVERT_DEFAULT;
bool swapRedBlue = false;
bool swapBytes = false;
int page = 0;
bool stale = false;
bool showingInfo = false;
bool haveBeat = false;
unsigned long lastBeat = 0;
static int silentRestarts = 0;          // restarts done for this stretch of silence (NVS key "srest"), capped at 3
static unsigned long linkRenewals = 0;

// Upload state (one upload at a time).
File uploadFile;
bool uploadAllowed = false;
bool uploadOk = false;
size_t uploadBytes = 0;
int uploadPage = 0;

// Firmware update state.
bool updateAllowed = false;
bool updateStarted = false;
bool updateOk = false;

// Twinkling stars: pages may end with b"STAR" + count (u16) + count * (x, y, rgb565) u16 LE, the
// stars of the background that nothing was drawn over, nor within two pixels of them. A star flares as a
// cross two pixels long each way; the colours under the cross are read back from the stored page.
struct Star { uint16_t x, y, base; uint16_t arm[8]; uint8_t step; };
static const int MAX_STARS = 128;
static const int8_t ARM_X[8] = {-2, -1, 1, 2, 0, 0, 0, 0};
static const int8_t ARM_Y[8] = {0, 0, 0, 0, -2, -1, 1, 2};
static const uint8_t STAR_LOOK[6] = {0, 1, 2, 3, 3, 0};   // rest, spark, glow, dim, dim, rest
static Star stars[MAX_STARS];
static int starCount = 0;
static bool animateStars = false;
static int activePages = PAGES;          // how many of the slots are shown (NVS key "np"): a deleted page is not cycled

// Scene animation: a page may end with b"ANIM" + payload length (u32 LE) + payload. The page then holds a clean
// background and the board moves small sprites over it (each sprite pixel is shown as 2x2), twinkles a few
// stars and sends a shooting star across. Whatever is uncovered is read back from the stored page itself, so
// nothing is ever written to flash. Payload, all little endian:
//   u8 sprites, u8 stars, u8 meteor, u8 0
//   meteor (if 1): i16 x0 y0 x1 y1 (where it may start), u16 periodMs, u16 head colour, u16 tail colour,
//                  u8 length (blocks), u8 speed (px per 40 ms tick)
//   stars:   i16 x, i16 y, u16 base, u16 bright, u16 dim
//   sprites: u16 w, u16 h, i16 x, i16 y, u8 frames, u8 steps, u16 stepMs, then steps * (u8 frame, i8 dx, i8 dy),
//            then frames * w * h RGB565 pixels (0xF81F = transparent)
static const int ANIM_SCALE = 2;
static const uint16_t ANIM_KEY = 0xF81F;
static const int MAX_SPRITES = 4, MAX_ANIM_STARS = 48, MAX_STEPS = 32;
static const uint32_t MAX_ANIM_BYTES = 80000;
struct AnimSprite {
  uint16_t w, h;
  int16_t x, y;
  uint8_t frames, steps;
  uint16_t stepMs;
  uint8_t stepFrame[MAX_STEPS];
  int8_t stepDx[MAX_STEPS], stepDy[MAX_STEPS];
  uint16_t *pixels;
  int16_t bx, by;
  uint16_t bw, bh;
  int lastStep;
};
struct AnimStar { int16_t x, y; uint16_t base, hi, lo; uint8_t step; };
struct Meteor {
  bool present, active;
  int16_t x0, y0, x1, y1;
  uint16_t periodMs, head, tail;
  uint8_t length, speed;
  int16_t hx, hy, ticks;
  int16_t lx, ly, lw, lh;        // what was painted last tick
  unsigned long next;
};
static AnimSprite sprites[MAX_SPRITES];
static int spriteCount = 0;
static AnimStar animStars[MAX_ANIM_STARS];
static int animStarCount = 0;
static Meteor meteor;
static uint16_t *region = nullptr;       // scratch for composing what is pushed to the panel
static size_t regionPixels = 0;
static bool animating = false;
// A native-resolution indexed photograph, masks and a small scratch band.
// No per-frame allocation, flash write, network fetch or account data logic.
static const int WAVE_TOP = 124, WAVE_ROWS = 116, WAVE_STEPS = 64, WAVE_MS = 100;
static const int BEACH_TOP = 132, BEACH_ROWS = 108, BEACH_W = 160, BEACH_H = 54, BEACH_FRAMES = 8, BEACH_BAND_ROWS = 16;
static const int BEACH_BANDS = (BEACH_ROWS+BEACH_BAND_ROWS-1)/BEACH_BAND_ROWS;
static const int BEACH_FILM_SLOTS = 4;  // baseline plus three rotating source frames
static const uint32_t BEACH_FILM_OFFSET = 8u+320u*240u*2u+8u+12u+512u;
static const int BEACH_SUBSTEPS = 128;
static const unsigned long BEACH_LOOP_MS = WAVE_MS*WAVE_STEPS/2;
static const int BEACH_CLAMP5 = 63*32, BEACH_CLAMP6 = 127*64;
static const size_t BEACH_HEAP_RESERVE = 80u*1024u;
static const int BOAT_X = 199, BOAT_Y = 76, BOAT_W = 40, BOAT_H = 56, BOAT_FRAMES = 4;
static const int16_t WAVE_SIN[128] = {0,6,13,19,25,31,37,43,49,55,60,66,71,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-13,-6};
static const uint16_t WAVE_CARRIER[WAVE_ROWS] = {0,30,42,52,60,67,73,79,84,90,94,99,103,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319,320};
struct Ocean {
  uint8_t *data;
  uint8_t version;
  uint16_t starts[WAVE_ROWS], palette[256], colour;
  uint32_t offsets[WAVE_ROWS];
  const uint8_t *indices, *keep, *glass;
  const uint8_t *boat;
  uint16_t *boatBase;
  uint8_t *beachBands[BEACH_BANDS];
  uint16_t cachedRows;
  uint16_t beachLeft[BEACH_BANDS], beachRight[BEACH_BANDS];
  bool streamFilm;
  uint8_t filmIds[BEACH_FILM_SLOTS-1];
  uint8_t *clampLut;
  uint16_t boatPalette[256];
  bool active;
  int lastStep;
  unsigned long started;
};
static Ocean ocean;
static unsigned long waveLastUs = 0, waveMaxUs = 0;
static unsigned long waveFrames = 0;
static unsigned long waveReadUs = 0, waveComposeUs = 0, wavePushUs = 0, waveBoatUs = 0;
static unsigned long waveLoopUs = 0, waveIndicatorUs = 0;
static unsigned long wavePreviousFrameMs = 0, waveGapMs = 0, waveMaxGapMs = 0, waveSlowFrames = 0;
static unsigned long waveCacheFree = 0, waveCacheLargest = 0, waveCacheAttemptAt = 0;
static File oceanFile;  // Kept only while this page is active; closed before the page is replaced.
// 0: untried, 1: budget, 2: allocation, 3: seek, 4: read, 5: cached.
static uint8_t waveCacheStatus = 0;
// A compact indexed landscape and rider poses. Version 4 also carries a
// transparent HUD, so the landscape can scroll behind it across the whole LCD.
static const int SCROLL_W = 512, SCROLL_H = 96, SCROLL_TOP = 48, SCROLL_MS = 120;
static const int SCROLL_SPEED = 2, RIDER_W = 32, RIDER_H = 36, RIDER_X = 40, RIDER_FRAMES = 4;
static const int ZOOM_RIDER_W = 48, ZOOM_RIDER_H = 54, ZOOM_SCALE = 3, ZOOM_ORIGIN = 20;
static const int ZOOM_CAMERA_SPEED = 4;  // physical pixels per 60 ms logical step
static const int ZOOM_RIDER_FRAMES = 5;
static const int ORIGINAL_RIDER_W = 56, ORIGINAL_RIDER_H = 64, ORIGINAL_RIDER_FRAMES = 8;
// Keep the 60 ms logical timeline and add one-pixel intermediate positions.
// The original (unzoomed) scene remains on its existing 60 ms cadence.
static const int SCROLL_FRAME_MS = SCROLL_MS / 2;
static const int SCROLL_SMOOTH_MS = SCROLL_FRAME_MS / 4, SCROLL_BAND_ROWS = 16;
static const uint32_t SCROLL_BYTES = 20u + 512u + SCROLL_W + SCROLL_W*SCROLL_H + RIDER_FRAMES*RIDER_W*RIDER_H*2u;
static const uint32_t ZOOM_SCROLL_BYTES = 20u + 512u + SCROLL_W + SCROLL_W*SCROLL_H + ZOOM_RIDER_FRAMES*ZOOM_RIDER_W*ZOOM_RIDER_H*2u;
static const uint32_t ORIGINAL_SCROLL_BYTES = 20u + 512u + SCROLL_W + SCROLL_W*SCROLL_H + ORIGINAL_RIDER_FRAMES*(ORIGINAL_RIDER_W/2)*(ORIGINAL_RIDER_H/2)*2u + (8u*16u+16u*16u+16u*16u+2u*16u*18u)*2u;
static const uint32_t FULL_SCROLL_BYTES = ORIGINAL_SCROLL_BYTES + 64u*2u + 320u*48u*6u/8u;
struct ScrollingWorld {
  uint8_t *data;
  const uint8_t *heights, *pixels, *rider, *coin, *shell, *usedBlock, *blockBackdrops, *hudPalette, *hudIndices;
  uint16_t palette[256];
  uint8_t version;
  bool active;
  unsigned long started, lastStep;
};
static ScrollingWorld scrolling;
static unsigned long scrollLastUs = 0, scrollMaxUs = 0, scrollFrames = 0;
static unsigned long scrollEpoch = 0;
static bool scrollEpochSet = false;
static bool redrawPending = false;     // the page on screen was just replaced by the PC: draw it again

static String pagePath(int n) { return "/p" + String(n) + ".raw"; }
static bool paired() { return token.length() == 16; }

// The boot splash: a run-length coded 256-colour picture streamed row by row.
static void drawSplash() {
  static uint16_t line[320];
  uint32_t i = 0;
  int x = 0, y = 0;
  while (i + 1 < SPLASH_RLE_LEN && y < 240) {
    uint8_t count = SPLASH_RLE[i];
    uint16_t color = SPLASH_PALETTE[SPLASH_RLE[i + 1]];
    i += 2;
    while (count-- && y < 240) {
      line[x++] = color;
      if (x == 320) {
        tft.pushImage(0, y, 320, 1, line);
        x = 0;
        y++;
      }
    }
  }
}

// One status line under the splash (the picture keeps that band empty).
static void splashStatus(const String &text) {
  tft.fillRect(0, 216, 320, 24, TFT_BLACK);
  tft.setTextColor(0x8C71, TFT_BLACK);   // soft blue-grey
  tft.setTextDatum(MC_DATUM);
  tft.drawString(text, tft.width() / 2, 228, 2);
}

static void message(const String &line1, const String &line2 = "", const String &line3 = "") {
  tft.fillScreen(TFT_BLACK);
  tft.setTextColor(TFT_WHITE, TFT_BLACK);
  tft.setTextDatum(MC_DATUM);
  tft.drawString(line1, tft.width() / 2, 80, 4);
  if (line2.length()) tft.drawString(line2, tft.width() / 2, 125, 2);
  if (line3.length()) tft.drawString(line3, tft.width() / 2, 150, 2);
}

// A well-formed frame: right magic, sane size, file length matches. Fills w/h.
static bool frameHeader(File &file, uint16_t &w, uint16_t &h) {
  uint8_t head[8];
  if (file.size() < 8 || file.read(head, 8) != 8 || memcmp(head, "TVF1", 4) != 0) return false;
  w = head[4] | (head[5] << 8);
  h = head[6] | (head[7] << 8);
  if (w == 0 || h == 0 || w > tft.width() || h > tft.height()) return false;
  uint32_t base = 8u + (uint32_t)w * h * 2u;
  if (file.size() == base) return true;
  if (file.size() < base + 6) return false;
  uint8_t tail[8] = {0};
  if (!file.seek(base) || file.read(tail, 6) != 6) return false;
  if (memcmp(tail, "ANIM", 4) == 0 || memcmp(tail, "WAVE", 4) == 0 || memcmp(tail, "SCRO", 4) == 0) {
    if (file.size() < base + 8 || file.read(tail + 6, 2) != 2) return false;
    uint32_t length = tail[4] | (tail[5] << 8) | ((uint32_t)tail[6] << 16) | ((uint32_t)tail[7] << 24);
    file.seek(8);
    return length >= 4 && length <= MAX_ANIM_BYTES && file.size() == base + 8 + length;
  }
  if (memcmp(tail, "STAR", 4) != 0) return false;
  uint16_t count = tail[4] | (tail[5] << 8);
  file.seek(8);   // leave the cursor where the caller expects it: right after the header
  return count <= 128 && file.size() == base + 6 + 6u * count;
}

static uint16_t fixColor(uint16_t p) {   // the same panel options that apply to the pixels
  if (swapBytes) p = (p >> 8) | (p << 8);
  if (swapRedBlue) p = ((p & 0xF800) >> 11) | (p & 0x07E0) | ((p & 0x001F) << 11);
  return p;
}

static uint16_t towardsWhite(uint16_t c, uint8_t eighths) {   // 8 = pure white
  uint16_t r = (c >> 11) & 31, g = (c >> 5) & 63, b = c & 31;
  r += (31 - r) * eighths / 8; g += (63 - g) * eighths / 8; b += (31 - b) * eighths / 8;
  return (r << 11) | (g << 5) | b;
}

static uint16_t aThird(uint16_t c) {   // a third of its light
  return ((((c >> 11) & 31) / 3) << 11) | ((((c >> 5) & 63) / 3) << 5) | ((c & 31) / 3);
}

// Draw a star in its current step of the cycle. `flaring` says whether the cross has to be repainted: while
// it is lit, and once more on the step after (to give the page's own pixels back).
static void paintStar(const Star &s, bool flaring) {
  const uint8_t look = STAR_LOOK[s.step];
  uint16_t centre = s.base;
  if (look == 1) centre = 0xFFFF;                         // spark: pure white
  else if (look == 2) centre = towardsWhite(s.base, 5);   // glow
  else if (look == 3) centre = aThird(s.base);            // dim: it almost goes out
  tft.drawPixel(s.x, s.y, fixColor(centre));
  if (!flaring) return;
  for (int i = 0; i < 8; i++) {
    const bool inner = i == 1 || i == 2 || i == 5 || i == 6;
    uint16_t c = s.arm[i];
    if (look == 1) c = towardsWhite(c, inner ? 6 : 3);
    else if (look == 2 && inner) c = towardsWhite(c, 2);
    tft.drawPixel(s.x + ARM_X[i], s.y + ARM_Y[i], fixColor(c));
  }
}

static bool pixelOf(File &file, uint16_t w, uint16_t x, uint16_t y, uint16_t &p) {
  uint8_t b[2];
  if (!file.seek(8u + ((uint32_t)y * w + x) * 2u) || file.read(b, 2) != 2) return false;
  p = b[0] | (b[1] << 8);
  return true;
}

// Read the star trailer of the open page (cursor must be right after the pixels), then the page's own
// colours under each cross so the flare can be taken away again exactly.
static void readStars(File &file, uint16_t w, uint16_t h) {
  starCount = 0;
  uint32_t base = 8u + (uint32_t)w * h * 2u;
  if (file.size() <= base + 6 || !file.seek(base)) return;
  uint8_t tail[6];
  if (file.read(tail, 6) != 6 || memcmp(tail, "STAR", 4) != 0) return;
  int count = tail[4] | (tail[5] << 8);
  for (int i = 0; i < count && starCount < MAX_STARS; i++) {
    uint8_t e[6];
    if (file.read(e, 6) != 6) break;
    Star &st = stars[starCount];
    st.x = e[0] | (e[1] << 8);
    st.y = e[2] | (e[3] << 8);
    st.base = e[4] | (e[5] << 8);
    st.step = 0;
    starCount++;
  }
  int kept = 0;
  for (int i = 0; i < starCount; i++) {   // a star too close to an edge, or one the file can't back, is dropped
    Star &st = stars[i];
    bool ok = st.x >= 2 && st.y >= 2 && st.x + 2 < w && st.y + 2 < h;
    for (int a = 0; ok && a < 8; a++) ok = pixelOf(file, w, st.x + ARM_X[a], st.y + ARM_Y[a], st.arm[a]);
    if (ok) stars[kept++] = st;
  }
  starCount = kept;
}

// ---- scene animation ---------------------------------------------------------------------------------------

static void freeAnim() {
  if (oceanFile) oceanFile.close();
  if (scrolling.data) free(scrolling.data);
  scrolling.data = nullptr;
  scrolling.active = false;
  if (ocean.data) free(ocean.data);
  ocean.data = nullptr;
  if (ocean.boatBase) free(ocean.boatBase);
  ocean.boatBase = nullptr;
  for (int i=0; i<BEACH_BANDS; i++) {
    if (ocean.beachBands[i]) free(ocean.beachBands[i]);
    ocean.beachBands[i] = nullptr;
  }
  ocean.cachedRows = 0;
  ocean.streamFilm = false;
  if (ocean.clampLut) free(ocean.clampLut);
  ocean.clampLut = nullptr;
  ocean.active = false;
  for (int i = 0; i < spriteCount; i++) {
    if (sprites[i].pixels) free(sprites[i].pixels);
    sprites[i].pixels = nullptr;
  }
  spriteCount = 0;
  animStarCount = 0;
  meteor.present = false;
  meteor.active = false;
  if (region) free(region);
  region = nullptr;
  regionPixels = 0;
  animating = false;
}

// Read a w x h rectangle of the stored page (raw RGB565 as the PC sent it) into `out`.
static bool readRect(File &file, int x, int y, int w, int h, uint16_t *out) {
  if (x < 0 || y < 0 || w <= 0 || h <= 0 || x + w > 320 || y + h > 240) return false;
  for (int r = 0; r < h; r++) {
    if (!file.seek(8u + ((uint32_t)(y + r) * 320u + (uint32_t)x) * 2u)) return false;
    if (file.read((uint8_t *)(out + (size_t)r * w), (size_t)w * 2) != (size_t)w * 2) return false;
  }
  return true;
}

static void pushRegion(int x, int y, int w, int h, uint16_t *buf) {
  if (swapRedBlue || swapBytes) for (size_t i = 0; i < (size_t)w * h; i++) buf[i] = fixColor(buf[i]);
  tft.pushImage(x, y, w, h, buf);
}

static uint16_t blend565(uint16_t bg, uint16_t fg, uint8_t alpha) {   // alpha 0..255 of `fg`
  uint16_t r = (((bg >> 11) & 31) * (255 - alpha) + ((fg >> 11) & 31) * alpha) / 255;
  uint16_t g = (((bg >> 5) & 63) * (255 - alpha) + ((fg >> 5) & 63) * alpha) / 255;
  uint16_t b = ((bg & 31) * (255 - alpha) + (fg & 31) * alpha) / 255;
  return (r << 11) | (g << 5) | b;
}

// Compose one sprite pose over the stored background and push the whole box in one go, so it never flickers.
static void drawSpriteStep(AnimSprite &s, int step, File &file) {
  if (!region || (size_t)s.bw * s.bh > regionPixels) return;
  if (!readRect(file, s.bx, s.by, s.bw, s.bh, region)) return;
  const uint16_t *src = s.pixels + (size_t)(s.stepFrame[step] % s.frames) * s.w * s.h;
  const int ox = s.x + s.stepDx[step] * 1 - s.bx, oy = s.y + s.stepDy[step] * 1 - s.by;
  for (int sy = 0; sy < s.h; sy++) {
    for (int sx = 0; sx < s.w; sx++) {
      const uint16_t c = src[(size_t)sy * s.w + sx];
      if (c == ANIM_KEY) continue;
      for (int ky = 0; ky < ANIM_SCALE; ky++) {
        const int ry = oy + sy * ANIM_SCALE + ky;
        if (ry < 0 || ry >= (int)s.bh) continue;
        for (int kx = 0; kx < ANIM_SCALE; kx++) {
          const int rx = ox + sx * ANIM_SCALE + kx;
          if (rx >= 0 && rx < (int)s.bw) region[(size_t)ry * s.bw + rx] = c;
        }
      }
    }
  }
  pushRegion(s.bx, s.by, s.bw, s.bh, region);
}

static bool readBytes(File &file, void *dst, size_t n) { return file.read((uint8_t *)dst, n) == n; }
static int16_t le16s(const uint8_t *p) { return (int16_t)(p[0] | (p[1] << 8)); }
static uint16_t le16u(const uint8_t *p) { return (uint16_t)(p[0] | (p[1] << 8)); }

static bool readScroll(File &file, const uint8_t *tag) {
  const uint32_t length = (uint32_t)tag[4] | ((uint32_t)tag[5]<<8) |
    ((uint32_t)tag[6]<<16) | ((uint32_t)tag[7]<<24);
  if ((length != SCROLL_BYTES && length != ZOOM_SCROLL_BYTES && length != ORIGINAL_SCROLL_BYTES && length != FULL_SCROLL_BYTES) || length > MAX_ANIM_BYTES ||
      file.size() != 153616u+length) return false;
  scrolling.data = (uint8_t *)malloc(length);
  if (!scrolling.data || !readBytes(file,scrolling.data,length)) { freeAnim(); return false; }
  const uint8_t *p = scrolling.data;
  const bool fullscreen=p[0] == 4, original=p[0] == 3 || fullscreen, zoom=p[0] == 2 || original;
  if ((p[0] != 1 && p[0] != 2 && p[0] != 3 && !fullscreen) ||
      length != (fullscreen ? FULL_SCROLL_BYTES : original ? ORIGINAL_SCROLL_BYTES : zoom ? ZOOM_SCROLL_BYTES : SCROLL_BYTES) ||
      p[1] != 0 || le16u(p+2) != SCROLL_W || le16u(p+4) != SCROLL_H ||
      le16u(p+6) != SCROLL_TOP || le16u(p+8) != SCROLL_MS || le16u(p+10) != SCROLL_SPEED ||
      le16u(p+12) != (original ? ORIGINAL_RIDER_W : zoom ? ZOOM_RIDER_W : RIDER_W) ||
      le16u(p+14) != (original ? ORIGINAL_RIDER_H : zoom ? ZOOM_RIDER_H : RIDER_H) || le16u(p+16) != RIDER_X ||
      le16u(p+18) != (original ? ORIGINAL_RIDER_FRAMES : zoom ? ZOOM_RIDER_FRAMES : RIDER_FRAMES)) { freeAnim(); return false; }
  scrolling.version=p[0];
  p += 20;
  for (int i=0; i<256; i++, p+=2) scrolling.palette[i]=le16u(p);
  scrolling.heights=p;
  for (int x=0; x<SCROLL_W; x++) if (p[x]<48 || p[x]>=SCROLL_H) { freeAnim(); return false; }
  p += SCROLL_W;
  scrolling.pixels=p;
  scrolling.rider=p+SCROLL_W*SCROLL_H;
  scrolling.coin=original ? scrolling.rider+ORIGINAL_RIDER_FRAMES*(ORIGINAL_RIDER_W/2)*(ORIGINAL_RIDER_H/2)*2u : nullptr;
  scrolling.shell=original ? scrolling.coin+8u*16u*2u : nullptr;
  scrolling.usedBlock=original ? scrolling.shell+16u*16u*2u : nullptr;
  scrolling.blockBackdrops=original ? scrolling.usedBlock+16u*16u*2u : nullptr;
  scrolling.hudPalette=fullscreen ? scrolling.blockBackdrops+2u*16u*18u*2u : nullptr;
  scrolling.hudIndices=fullscreen ? scrolling.hudPalette+64u*2u : nullptr;
  regionPixels=320*SCROLL_BAND_ROWS;
  region=(uint16_t *)malloc(regionPixels*2);
  if (!region) { freeAnim(); return false; }
  if (!scrollEpochSet) { scrollEpoch=animationClock.time(millis()); scrollEpochSet=true; }
  scrolling.started=scrollEpoch;
  const int frameMs=scrolling.version >= 2 ? SCROLL_SMOOTH_MS : SCROLL_FRAME_MS;
  scrolling.lastStep=(uint32_t(animationClock.time(millis())-scrolling.started))/frameMs;
  scrolling.active=true;
  animating=true;
  scrollLastUs=scrollMaxUs=scrollFrames=0;
  return true;
}

static void drawScroll(unsigned long frameStep) {
  if (!scrolling.active || !region) return;
  const unsigned long began=micros();
  const bool fullscreen=scrolling.version == 4, original=scrolling.version >= 3, zoom=scrolling.version >= 2;
  const unsigned long step=zoom ? frameStep/4 : frameStep;
  const int quarter=zoom ? frameStep%4 : 0;
  const int actorW=original ? ORIGINAL_RIDER_W : zoom ? ZOOM_RIDER_W : RIDER_W;
  const int actorH=original ? ORIGINAL_RIDER_H : zoom ? ZOOM_RIDER_H : RIDER_H;
  const int camera=zoom ? ((step%384)*ZOOM_CAMERA_SPEED + quarter)%(SCROLL_W*ZOOM_SCALE) : 0;
  const int offset=zoom ? camera/ZOOM_SCALE : (step*SCROLL_SPEED/2)%SCROLL_W;
  const int foot=zoom ? ((camera+RIDER_X+actorW/2)/ZOOM_SCALE)%SCROLL_W
                      : (offset+(RIDER_X+actorW/2)/2)%SCROLL_W;
  static const uint8_t jump[] = {0,4,8,14,20,26,32,38,42,44,
                                 44,44,44,44,44,44,44,44,44,44,44,44,44,44,
                                 42,38,32,26,20,14,8,4,2,0};
  static const uint8_t hop[] = {0,6,12,18,24,33,24,18,12,6,0};
  static const uint8_t originalHop[] = {0,3,6,9,11,14,11,9,6,3,0};
  static const uint8_t originalJump[] = {0,16,40,63,83,96,99,96,82,61,36,10,0};
  static const uint8_t coinMask[] = {12,30,63,63,63,63,63,30,12};
  const int zoomPhase=(int)(step%192);
  int leap=0;
  if (zoom) {
    auto leapAt = [&](int p) {
      const int phase=p-54, blockHop=p-99;
      if (original && phase>=0 && phase<(int)sizeof(originalJump)) return (int)originalJump[phase];
      if (!original && phase>=0 && phase<=27) return (312*phase*(27-phase)+364)/(27*27);
      if (blockHop>=0 && blockHop<(int)sizeof(hop)) return (int)(original ? originalHop[blockHop] : hop[blockHop]);
      return 0;
    };
    leap=leapAt(zoomPhase);
    if (quarter) {
      // Do not enter the block during the positions immediately before it
      // rises: at the next logical step Mario touches it and it moves up.
      if (zoomPhase != 103) leap=(leap*(4-quarter)+leapAt((zoomPhase+1)%192)*quarter)/4;
    }
  } else {
    const int phase=(int)(step%256)-52;
    if (phase>=0 && phase<(int)sizeof(jump)*2) {
      const int index=phase/2;
      leap=jump[index];
      if (phase%2) leap=(leap+(index+1<(int)sizeof(jump) ? jump[index+1] : 0))/2;
    }
  }
  int groundY=zoom ? SCROLL_TOP+ZOOM_SCALE*(scrolling.heights[foot]-ZOOM_ORIGIN)
                   : SCROLL_TOP+2*scrolling.heights[foot];
  const int airPhase=(zoomPhase-54)*4+quarter;
  const int airDuration=(original ? 12 : 27)*4;
  if (zoom && airPhase>=0 && airPhase<=airDuration) {
    const unsigned long start=step-airPhase/4;
    const int firstCamera=(start*ZOOM_CAMERA_SPEED)%(SCROLL_W*ZOOM_SCALE);
    const int lastCamera=((start+airDuration/4)*ZOOM_CAMERA_SPEED)%(SCROLL_W*ZOOM_SCALE);
    const int first=((firstCamera+RIDER_X+actorW/2)/ZOOM_SCALE)%SCROLL_W;
    const int last=((lastCamera+RIDER_X+actorW/2)/ZOOM_SCALE)%SCROLL_W;
    const int change=ZOOM_SCALE*((int)scrolling.heights[last]-(int)scrolling.heights[first])*airPhase;
    groundY=SCROLL_TOP+ZOOM_SCALE*(scrolling.heights[first]-ZOOM_ORIGIN)+change/airDuration;
  }
  const int shellWorld=step%384<192 ? 217 : 473;
  const int shellLeft=651-10*zoomPhase-(10*quarter)/4;
  const int shellTop=SCROLL_TOP+ZOOM_SCALE*(scrolling.heights[shellWorld]-ZOOM_ORIGIN)-32;
  if (original && quarter && shellLeft<RIDER_X+actorW && shellLeft+32>RIDER_X) {
    // Keep the interpolated landing clear until the shell has fully passed.
    leap=max(leap,groundY-shellTop);
  }
  const int actorY=groundY-actorH-leap;
  int frame=zoom && leap ? 4 : (step/2)%RIDER_FRAMES;
  if (original && leap) {
    const int flight=zoomPhase>54 && zoomPhase<67 ? zoomPhase-54 : zoomPhase-99;
    frame=flight<=2 ? 4 : flight<=4 ? 5 : flight<=8 ? 6 : 7;
  }
  const int sourceW=original ? actorW/2 : actorW, sourceH=original ? actorH/2 : actorH;
  const uint8_t *pose=scrolling.rider+frame*sourceW*sourceH*2u;
  const int coinAge=zoom ? zoomPhase-104 : -1;
  const bool coinActive=coinAge>=0 && coinAge<16;
  const bool blockBump=coinActive && coinAge<2;
  const int hitBlock=step%384<192 ? 157 : 413;
  const int blockLeft=hitBlock*ZOOM_SCALE-camera;
  const int blockTop=SCROLL_TOP+ZOOM_SCALE*(36-ZOOM_ORIGIN);
  const int blockSize=original ? 48 : 42;
  const int coinTop=blockTop-5-min(coinAge*4+(coinActive ? quarter : 0),original ? 48 : 36);
  // Each source row occupies two or three LCD rows. Reuse its clean, scaled
  // background before composing the independently moving sprites and HUD.
  static uint16_t backgroundLine[320];
  int cachedWorldY=-1;
  for (int band=fullscreen ? -SCROLL_TOP : 0; band<SCROLL_H*2; band+=SCROLL_BAND_ROWS) {
    for (int row=0; row<SCROLL_BAND_ROWS; row++) {
      const int y=SCROLL_TOP+band+row;
      const int worldY=fullscreen ? ZOOM_ORIGIN-SCROLL_TOP/ZOOM_SCALE+y/ZOOM_SCALE
                                 : zoom ? ZOOM_ORIGIN+(band+row)/ZOOM_SCALE : (band+row)/2;
      const uint8_t *world=scrolling.pixels+worldY*SCROLL_W;
      uint16_t *line=region+row*320;
      if (worldY != cachedWorldY) {
        if (zoom) {
          int x=0, sample=offset, repeat=ZOOM_SCALE-camera%ZOOM_SCALE;
          while (x<320) {
            const uint16_t color=scrolling.palette[world[sample]];
            for (int n=0; n<repeat && x<320; n++) backgroundLine[x++]=color;
            sample=(sample+1)%SCROLL_W;
            repeat=ZOOM_SCALE;
          }
        } else {
          for (int x=0; x<160; x++) {
            const uint16_t color=scrolling.palette[world[(offset+x)%SCROLL_W]];
            backgroundLine[2*x]=backgroundLine[2*x+1]=color;
          }
        }
        cachedWorldY=worldY;
      }
      memcpy(line, backgroundLine, sizeof(backgroundLine));
      if (original) {
        if (shellLeft<320 && shellLeft+32>0) {
          if (y>=shellTop && y<shellTop+32) {
            const int sy=(y-shellTop)/2;
            for (int col=0; col<32; col++) {
              const int x=shellLeft+col;
              const uint16_t color=le16u(scrolling.shell+2*(sy*16+col/2));
              if (x>=0 && x<320 && color != ANIM_KEY) line[x]=color;
            }
          }
        }
      }
      if (original && zoomPhase>=104 && blockLeft<320 && blockLeft+48>0) {
        if (y>=blockTop-3 && y<blockTop+51) {
          const int sy=(y-(blockTop-3))/3;
          const uint8_t *backdrop=scrolling.blockBackdrops+(step%384<192 ? 0 : 16u*18u*2u);
          for (int x=max(0,blockLeft); x<min(320,blockLeft+48); x++) {
            line[x]=le16u(backdrop+2*(sy*16+(x-blockLeft)/3));
          }
        }
        const int usedTop=blockTop-(blockBump ? 3 : 0);
        if (y>=usedTop && y<usedTop+48) {
          const int sy=(y-usedTop)/3;
          for (int x=max(0,blockLeft); x<min(320,blockLeft+48); x++) {
            const uint16_t color=le16u(scrolling.usedBlock+2*(sy*16+(x-blockLeft)/3));
            if (color != ANIM_KEY) line[x]=color;
          }
        }
      }
      if (!original && blockBump && y>=blockTop-3 && y<blockTop+blockSize) {
        const int sourceY=min(worldY+1,original ? 52 : 50);
        const uint8_t *source=scrolling.pixels+sourceY*SCROLL_W;
        for (int x=max(0,blockLeft); x<min(320,blockLeft+blockSize); x++) {
          const int sourceX=((camera+x)/ZOOM_SCALE)%SCROLL_W;
          line[x]=scrolling.palette[source[sourceX]];
        }
      }
      if (original && coinActive && y>=coinTop && y<coinTop+48 && y<blockTop-(blockBump ? 3 : 0)) {
        const int sy=(y-coinTop)/3;
        for (int col=0; col<24; col++) {
          const int x=blockLeft+12+col;
          const uint16_t color=le16u(scrolling.coin+2*(sy*8+col/3));
          if (x>=0 && x<320 && color != ANIM_KEY) line[x]=color;
        }
      } else if (!original && coinActive && y>=coinTop && y<coinTop+18 && y<blockTop-(blockBump ? 3 : 0)) {
        const uint8_t mask=coinMask[(y-coinTop)/2];
        for (int col=0; col<12; col++) {
          const int x=blockLeft+15+col, bit=col/2;
          if (x>=0 && x<320 && (mask & (1<<(5-bit)))) {
            line[x]=bit==1 ? 0xffd6 : (bit==0 || bit==5) ? 0x9ac4 : 0xff0b;
          }
        }
      }
      if (y>=actorY && y<actorY+actorH) {
        const int sy=y-actorY;
        for (int sx=0; sx<actorW; sx++) {
          const uint16_t color=le16u(pose+2*((original ? sy/2 : sy)*sourceW+(original ? sx/2 : sx)));
          if (color != ANIM_KEY) line[RIDER_X+sx]=color;
        }
      }
      if (fullscreen && y<SCROLL_TOP) {
        const uint8_t *indices=scrolling.hudIndices+y*(320*6/8);
        for (int x=0; x<320; x+=4) {
          const uint8_t a=*indices++, b=*indices++, c=*indices++;
          const uint8_t entry[4] = {(uint8_t)(a&63), (uint8_t)((a>>6)|((b&15)<<2)),
                                    (uint8_t)((b>>4)|((c&3)<<4)), (uint8_t)(c>>2)};
          for (int j=0; j<4; j++) if (entry[j]) line[x+j]=le16u(scrolling.hudPalette+2*entry[j]);
        }
      }
    }
    pushRegion(0,SCROLL_TOP+band,320,SCROLL_BAND_ROWS,region);
  }
  scrollLastUs=micros()-began;
  scrollMaxUs=max(scrollMaxUs,scrollLastUs);
  ++scrollFrames;
}

static int floorDivide(int n, int d) { return n >= 0 ? n / d : -((-n + d - 1) / d); }

static int waveEdge(int y) {
  static const int16_t coast[][2] = {{124,173},{132,158},{144,146},{152,126},
    {160,123},{170,108},{180,104},{190,94},{200,78},{210,72},{220,78},{239,77}};
  for (int i = 0; i < 11; i++) {
    if (y <= coast[i+1][0]) return coast[i][1] +
      floorDivide((coast[i+1][1]-coast[i][1])*(y-coast[i][0]), coast[i+1][0]-coast[i][0]);
  }
  return 77;
}

static void cacheBeach(File &file) {
  // Allocate each band separately so fragmented heap can still hold the full
  // photograph. Never spend the memory reserved for Wi-Fi and control requests.
  const size_t rowBytes = 320u*2u;
  const size_t freeBytes = ESP.getFreeHeap(), largest = ESP.getMaxAllocHeap();
  waveCacheFree = freeBytes; waveCacheLargest = largest; waveCacheAttemptAt = millis();
  size_t budget = freeBytes > BEACH_HEAP_RESERVE ? freeBytes-BEACH_HEAP_RESERVE : 0u;
  if (budget < rowBytes*BEACH_BAND_ROWS) { waveCacheStatus = 1; return; }
  if (!file.seek(8u+(uint32_t)BEACH_TOP*rowBytes)) {
    waveCacheStatus = 3; return;
  }
  for (int i=0; i<BEACH_BANDS; i++) {
    const size_t rows = min(BEACH_BAND_ROWS, BEACH_ROWS-i*BEACH_BAND_ROWS);
    const size_t bytes = rowBytes*rows;
    if (bytes > budget || bytes > ESP.getMaxAllocHeap()) break;
    uint8_t *band = (uint8_t *)malloc(bytes);
    if (!band) break;
    if (file.read(band, bytes) != bytes) {
      free(band);
      for (int j=0; j<i; j++) { free(ocean.beachBands[j]); ocean.beachBands[j]=nullptr; }
      ocean.cachedRows=0; waveCacheStatus=4; return;
    }
    ocean.beachBands[i]=band;
    ocean.cachedRows += rows;
    budget -= bytes;
  }
  waveCacheStatus = ocean.cachedRows ? 5 : 2;
}

static bool readWave(File &file, const uint8_t *tag) {
  const uint32_t length = (uint32_t)tag[4] | ((uint32_t)tag[5]<<8) |
    ((uint32_t)tag[6]<<16) | ((uint32_t)tag[7]<<24);
  const uint32_t fixed = 12u + WAVE_ROWS*2u + 512u + 2u*(320u*WAVE_ROWS/8u);
  if (length < 12u || length > MAX_ANIM_BYTES || file.size() != 153616u+length) return false;
  ocean.data = (uint8_t *)malloc(length);
  if (!ocean.data) return false;
  if (!readBytes(file, ocean.data, length)) { freeAnim(); return false; }
  const uint8_t *p = ocean.data;
  const int version = p[0];
  const bool beach = version == 2 || version == 3;
  const bool hasBoat = version == 3 && p[1] == 1;
  if ((version != 1 && !beach) || (p[1] != 0 && !hasBoat) ||
      le16u(p+2) != (beach ? BEACH_TOP : WAVE_TOP) ||
      le16u(p+4) != (beach ? BEACH_ROWS : WAVE_ROWS) ||
      le16u(p+6) != WAVE_MS || le16u(p+8) != WAVE_STEPS ||
      (version == 2 && le16u(p+10) != 0) ||
      (version == 3 && le16u(p+10) != 2)) { freeAnim(); return false; }
  ocean.version = version;
  ocean.colour = le16u(p+10);
  p += 12;
  ocean.boat = nullptr;
  if (beach) {
    const uint32_t filmSize = 12u+512u+BEACH_W*BEACH_H*BEACH_FRAMES;
    const uint32_t boatSize = hasBoat ? 512u+BOAT_W*BOAT_H*BOAT_FRAMES : 0;
    if (length != filmSize+boatSize) { freeAnim(); return false; }
    for (int i = 0; i < 256; i++, p += 2) ocean.palette[i] = le16u(p);
    ocean.indices = p;
    p += BEACH_W*BEACH_H*BEACH_FRAMES;
    if (hasBoat) {
      for (int i = 0; i < 256; i++, p += 2) ocean.boatPalette[i] = le16u(p);
      ocean.boat = p;
    }
    if (version == 3) {
      // Find the union of changed pixels in each band before compacting the
      // film. Entirely still parts of any photograph can then stay untouched.
      const size_t stride = BEACH_W*BEACH_H;
      for (int i=0; i<BEACH_BANDS; i++) {
        ocean.beachLeft[i]=320; ocean.beachRight[i]=0;
      }
      for (int y=0; y<BEACH_H; y++) for (int x=0; x<BEACH_W; x++) {
        const size_t pos=(size_t)y*BEACH_W+x;
        const uint16_t base=ocean.palette[ocean.indices[pos]];
        bool changes=false;
        for (int frame=1; frame<BEACH_FRAMES && !changes; frame++)
          changes=ocean.palette[ocean.indices[frame*stride+pos]] != base;
        if (changes) {
          const int band=(y*2)/BEACH_BAND_ROWS;
          ocean.beachLeft[band]=min((int)ocean.beachLeft[band],x*2);
          ocean.beachRight[band]=max((int)ocean.beachRight[band],x*2+2);
        }
      }
      // Compact in place: allocating a second copy first needs extra heap at
      // precisely the moment when the full film is already using the most.
      // Keep the baseline, three source frames and boat; the other frames are
      // read on demand. Palettes have already been copied into ocean above.
      const size_t boatBytes = hasBoat ? BOAT_W*BOAT_H*BOAT_FRAMES : 0;
      const size_t compactBytes = BEACH_FILM_SLOTS*stride+boatBytes;
      memmove(ocean.data, ocean.indices, BEACH_FILM_SLOTS*stride);
      if (hasBoat) memmove(ocean.data+BEACH_FILM_SLOTS*stride, ocean.boat, boatBytes);
      // A failed shrink keeps the original allocation valid; the compacted
      // content still works, just with less memory available for the cache.
      uint8_t *compact = (uint8_t *)realloc(ocean.data, compactBytes);
      if (compact) ocean.data = compact;
      ocean.indices = ocean.data;
      ocean.boat = hasBoat ? ocean.data+BEACH_FILM_SLOTS*stride : nullptr;
      ocean.streamFilm = true;
      for (int i=0; i<BEACH_FILM_SLOTS-1; i++) ocean.filmIds[i]=i+1;
    }
    ocean.keep = ocean.glass = nullptr;
  } else {
    if (length < fixed) { freeAnim(); return false; }
    uint32_t count = 0;
    for (int y = 0; y < WAVE_ROWS; y++, p += 2) {
      ocean.starts[y] = le16u(p);
      if (ocean.starts[y] >= 320) { freeAnim(); return false; }
      ocean.offsets[y] = count;
      count += 320-ocean.starts[y];
    }
    if (length != fixed+count) { freeAnim(); return false; }
    for (int i = 0; i < 256; i++, p += 2) ocean.palette[i] = le16u(p);
    ocean.indices = p;
    ocean.keep = p+count;
    ocean.glass = ocean.keep+320*WAVE_ROWS/8;
  }
  regionPixels = 320*(beach ? BEACH_BAND_ROWS : 8);
  region = (uint16_t *)malloc(regionPixels*2);
  if (!region) { freeAnim(); return false; }
  if (beach) {
    // A small optional saturation lookup avoids clamping every channel of
    // every full-resolution pixel on every frame. Low memory uses the exact
    // original arithmetic instead; the source photo is never downsampled.
    ocean.clampLut = (uint8_t *)malloc(BEACH_CLAMP5+BEACH_CLAMP6);
    if (ocean.clampLut) {
      for (int d=-31; d<=31; d++) for (int c=0; c<32; c++)
        ocean.clampLut[(d+31)*32+c] = max(0,min(31,c+d));
      for (int d=-63; d<=63; d++) for (int c=0; c<64; c++)
        ocean.clampLut[BEACH_CLAMP5+(d+63)*64+c] = max(0,min(63,c+d));
    }
  }
  if (ocean.boat) {
    // The unchanging photograph was previously read in 56 separate seeks on
    // every frame. A small optional cache keeps the same pixels and falls back
    // to the original file reads if memory is tight.
    ocean.boatBase = (uint16_t *)malloc(BOAT_W*BOAT_H*2u);
    if (ocean.boatBase && !readRect(file, BOAT_X, BOAT_Y, BOAT_W, BOAT_H, ocean.boatBase)) {
      free(ocean.boatBase);
      ocean.boatBase = nullptr;
    }
  }
  waveCacheStatus = 0; waveCacheFree = waveCacheLargest = waveCacheAttemptAt = 0;
  if (beach) cacheBeach(file);
  ocean.lastStep = 0;
  ocean.started = animationClock.time(millis());
  ocean.active = true;
  animating = true;
  waveLastUs = waveMaxUs = 0;
  waveFrames = 0;
  waveReadUs = waveComposeUs = wavePushUs = waveBoatUs = waveLoopUs = waveIndicatorUs = 0;
  wavePreviousFrameMs = waveGapMs = waveMaxGapMs = waveSlowFrames = 0;
  return true;
}

static uint16_t wavePixel(int x, int y) {
  return ocean.palette[ocean.indices[ocean.offsets[y]+x-ocean.starts[y]]];
}

// Bilinear RGB565 sampling retains the photograph's fine one-pixel detail.
static uint16_t waveSample(int xq, int yq) {
  yq = max(0, min((WAVE_ROWS-1)*256, yq));
  const int y = yq/256, fy = yq%256, y1 = min(WAVE_ROWS-1, y+1);
  xq = max((int)max(ocean.starts[y], ocean.starts[y1])*256, min(319*256, xq));
  const int x = xq/256, fx = xq%256, x1 = min(319, x+1);
  const uint16_t a = wavePixel(x,y), b = wavePixel(x1,y), c = wavePixel(x,y1), d = wavePixel(x1,y1);
  uint16_t out = 0;
  const int shifts[] = {11,5,0}, masks[] = {31,63,31};
  for (int i = 0; i < 3; i++) {
    const int shift = shifts[i], mask = masks[i];
    const int ab = ((a>>shift)&mask)*(256-fx)+((b>>shift)&mask)*fx;
    const int cd = ((c>>shift)&mask)*(256-fx)+((d>>shift)&mask)*fx;
    out |= ((ab*(256-fy)+cd*fy+32768)/65536)<<shift;
  }
  return out;
}

// Two travelling foam crests per loop, with little gaps so they break up
// naturally. The rest of the sea ripples independently underneath them.
static uint8_t waveFoam(int x, int yy, int shore, int step) {
  const int distance = x-shore;
  if (distance < 0) return 0;
  const int bend = ((WAVE_SIN[(yy*2)&127]+128)>>3) + ((WAVE_SIN[(yy*5)&127]+128)>>4);
  const int phase = (distance*4+step*8+bend)&255;
  if (phase >= 48) return 0;
  const int texture = WAVE_SIN[(yy*7+x*3+step*2)&127]+128;
  if (texture < 28) return 0;
  const int strength = 70+80*yy/(WAVE_ROWS-1);
  return ((48-phase)*strength/48)*(80+texture)/336;
}

static uint16_t beachAdjust(uint16_t c, int dr, int dg, int db) {
  const int r = max(0,min(31,((c>>11)&31)+dr));
  const int g = max(0,min(63,((c>>5)&63)+dg));
  const int b = max(0,min(31,(c&31)+db));
  return (r<<11)|(g<<5)|b;
}

static const uint8_t *beachFilmFrame(File &file, int frame, int keepA, int keepB) {
  const size_t stride = BEACH_W*BEACH_H;
  if (!ocean.streamFilm || frame == 0) return ocean.indices+frame*stride;
  for (int slot=0; slot<BEACH_FILM_SLOTS-1; slot++)
    if (ocean.filmIds[slot] == frame) return ocean.indices+(slot+1)*stride;
  for (int slot=0; slot<BEACH_FILM_SLOTS-1; slot++) {
    if (ocean.filmIds[slot] == keepA || ocean.filmIds[slot] == keepB) continue;
    uint8_t *destination = ocean.data+(slot+1)*stride;
    ocean.filmIds[slot]=255; // never use a partial read as an animation frame
    if (!file.seek(BEACH_FILM_OFFSET+(uint32_t)frame*stride) || file.read(destination,stride) != stride) return nullptr;
    ocean.filmIds[slot]=frame;
    return destination;
  }
  return nullptr;
}

static void drawBoat(int step, File &file) {
  if (!ocean.boat) return;
  const int stride = BOAT_W*BOAT_H, first = step/16, mix = step%16;
  const uint8_t *zero = ocean.boat, *a = zero+first*stride;
  const uint8_t *b = zero+((first+1)%BOAT_FRAMES)*stride;
  if (ocean.boatBase) memcpy(region, ocean.boatBase, BOAT_W*BOAT_H*2u);
  for (int y = 0; y < BOAT_H; y++) {
    if (!ocean.boatBase && (!file.seek(8u+((uint32_t)(BOAT_Y+y)*320u+BOAT_X)*2u) ||
        file.read((uint8_t *)(region+y*BOAT_W), BOAT_W*2u) != BOAT_W*2u)) return;
    for (int x = 0; x < BOAT_W; x++) {
      const int pos = y*BOAT_W+x;
      const uint16_t c0 = ocean.boatPalette[zero[pos]], ca = ocean.boatPalette[a[pos]], cb = ocean.boatPalette[b[pos]];
      const int dr = (((ca>>11)&31)*(16-mix)+((cb>>11)&31)*mix+8)/16-((c0>>11)&31);
      const int dg = (((ca>>5)&63)*(16-mix)+((cb>>5)&63)*mix+8)/16-((c0>>5)&63);
      const int db = ((ca&31)*(16-mix)+(cb&31)*mix+8)/16-(c0&31);
      if (!(dr || dg || db)) continue;
      region[pos] = beachAdjust(region[pos],dr,dg,db);
    }
  }
  pushRegion(BOAT_X,BOAT_Y,BOAT_W,BOAT_H,region);
}

static void drawBeach(int step, int boatStep, File &file) {
  const unsigned long began = micros();
  const unsigned long frameAt = millis();
  unsigned long readUs = 0, composeUs = 0, pushUs = 0, stamp = 0;
  int nextFileBand = -1;
  // WAVE3 samples the current time more finely so a 45 ms hardware frame is
  // not forced onto a 25 ms grid. WAVE2 keeps its exact original poses.
  const int phase = ocean.version == 3 ? step : step*(BEACH_SUBSTEPS/8);
  const int first = phase/BEACH_SUBSTEPS, mix = phase%BEACH_SUBSTEPS;
  const uint8_t *zero = ocean.indices;
  const int next=(first+1)%BEACH_FRAMES;
  const uint8_t *a = beachFilmFrame(file,first,first,next), *b = beachFilmFrame(file,next,first,next);
  if (!a || !b) return;
  for (int band = 0; band < BEACH_ROWS; band += BEACH_BAND_ROWS) {
    const int rows = min(BEACH_BAND_ROWS, BEACH_ROWS-band);
    const int bandIndex=band/BEACH_BAND_ROWS;
    const int left=ocean.version == 3 ? ocean.beachLeft[bandIndex] : 0;
    const int right=ocean.version == 3 ? ocean.beachRight[bandIndex] : 320;
    const int width=right-left;
    if (width <= 0) continue;
    const size_t bytes = rows*320u*2u;
    stamp = micros();
    if (ocean.beachBands[bandIndex]) {
      memcpy(region, ocean.beachBands[bandIndex], bytes);
    } else {
      if (nextFileBand != band && !file.seek(8u+(uint32_t)(BEACH_TOP+band)*320u*2u)) return;
      if (file.read((uint8_t *)region, bytes) != bytes) return;
      nextFileBand=band+rows;
    }
    readUs += micros()-stamp;
    stamp = micros();
    for (int r = 0; r < rows; r += 2) {
      const int yy = (band+r)/2, fade = min(8,yy);
      for (int x = left/2; x < right/2; x++) {
        const int pos = yy*BEACH_W+x;
        const uint16_t c0 = ocean.palette[zero[pos]], ca = ocean.palette[a[pos]], cb = ocean.palette[b[pos]];
        if (ca == c0 && cb == c0) continue;
        // Spread quantisation thresholds spatially. Otherwise small colour
        // changes make thousands of water pixels jump at the same instant.
        // The stable pattern is exact at source frames and the loop seam.
        const int bias = ocean.version == 3 ? (pos*73+19)&(BEACH_SUBSTEPS-1) : BEACH_SUBSTEPS/2;
        int dr = ((((ca>>11)&31)*(BEACH_SUBSTEPS-mix)+((cb>>11)&31)*mix+bias)/BEACH_SUBSTEPS)-((c0>>11)&31);
        int dg = ((((ca>>5)&63)*(BEACH_SUBSTEPS-mix)+((cb>>5)&63)*mix+bias)/BEACH_SUBSTEPS)-((c0>>5)&63);
        int db = (((ca&31)*(BEACH_SUBSTEPS-mix)+(cb&31)*mix+bias)/BEACH_SUBSTEPS)-(c0&31);
        // Only the first eight source rows need the horizon fade.
        if (fade < 8) { dr = dr*fade/8; dg = dg*fade/8; db = db*fade/8; }
        if (!(dr || dg || db)) continue;
        if (ocean.clampLut) {
          const uint8_t *rr=ocean.clampLut+(dr+31)*32;
          const uint8_t *gg=ocean.clampLut+BEACH_CLAMP5+(dg+63)*64;
          const uint8_t *bb=ocean.clampLut+(db+31)*32;
          for (int dy = 0; dy < 2; dy++) for (int dx = 0; dx < 2; dx++) {
            uint16_t &c = region[(r+dy)*320+x*2+dx];
            c = (rr[c>>11]<<11) | (gg[(c>>5)&63]<<5) | bb[c&31];
          }
        } else {
          for (int dy = 0; dy < 2; dy++) for (int dx = 0; dx < 2; dx++) {
            uint16_t &c = region[(r+dy)*320+x*2+dx];
            c = beachAdjust(c,dr,dg,db);
          }
        }
      }
    }
    composeUs += micros()-stamp;
    stamp = micros();
    if (width < 320) for (int r=0; r<rows; r++)
      memmove(region+(size_t)r*width, region+(size_t)r*320+left, width*sizeof(uint16_t));
    pushRegion(left,BEACH_TOP+band,width,rows,region);
    pushUs += micros()-stamp;
  }
  stamp = micros();
  drawBoat(boatStep,file);
  waveBoatUs = micros()-stamp;
  waveReadUs = readUs; waveComposeUs = composeUs; wavePushUs = pushUs;
  waveLastUs = micros()-began;
  waveMaxUs = max(waveMaxUs,waveLastUs);
  if (waveFrames) {
    waveGapMs = frameAt-wavePreviousFrameMs;
    waveMaxGapMs = max(waveMaxGapMs,waveGapMs);
    if (waveGapMs > 100) waveSlowFrames++;
  }
  wavePreviousFrameMs = frameAt;
  waveFrames++;
}

static void drawWave(int step, int boatStep, File &file) {
  if (!ocean.active || !region) return;
  if (ocean.version == 2 || ocean.version == 3) { drawBeach(step,boatStep,file); return; }
  const unsigned long began = micros();
  const int cosine = WAVE_SIN[(step*2+32)&127];
  for (int band = 0; band < WAVE_ROWS; band += 8) {
    const int rows = min(8, WAVE_ROWS-band);
    // One contiguous file read per band, rather than seeking for every pixel/row.
    if (!file.seek(8u+(uint32_t)(WAVE_TOP+band)*320u*2u) ||
        file.read((uint8_t *)region, rows*320u*2u) != rows*320u*2u) return;
    for (int r = 0; r < rows; r++) {
      const int yy = band+r, shore = waveEdge(WAVE_TOP+yy);
      const int tide = (128-cosine)*(10+36*yy/(WAVE_ROWS-1));
      const int ripple = 80+720*yy/(WAVE_ROWS-1);
      for (int x = max(0,shore-54); x < 320; x++) {
        const int idx = yy*320+x, bit = 1<<(idx&7);
        if (ocean.keep[idx/8]&bit) continue;
        // Monotonic falloff avoids folding the photograph into flat streaks.
        const int near = max(0,256-max(0,x-shore)*3);
        const int k = (WAVE_CARRIER[yy]+x/18)&127;
        const int dx = tide*near/256 + floorDivide(ripple*(WAVE_SIN[(k-step*2)&127]-WAVE_SIN[k]),128);
        const int dy = floorDivide(ripple*(WAVE_SIN[(k-step*2+32)&127]-WAVE_SIN[(k+32)&127]),160);
        int wet = max(0,min(255,floorDivide(((x-shore)*256+dx+768)*255,1536)));
        wet = wet*wet*(765-2*wet)/65025;
        if (!wet) continue;
        uint16_t c = waveSample(x*256+dx, yy*256+dy);
        const uint8_t foam = waveFoam(x, yy, shore, step);
        if (foam) c = blend565(c,0xffff,foam);
        if (ocean.glass[idx/8]&bit) c = blend565(c,ocean.colour,156);
        uint16_t &cell = region[r*320+x];
        cell = blend565(cell,c,wet);
      }
    }
    pushRegion(0,WAVE_TOP+band,320,rows,region);
  }
  waveLastUs = micros()-began;
  waveMaxUs = max(waveMaxUs,waveLastUs);
}

// Parse the ANIM trailer of a full-screen page. Anything wrong frees what was taken and the page stays static.
static bool readAnim(File &file, uint16_t w, uint16_t h) {
  freeAnim();
  if (w != 320 || h != 240) return false;
  const uint32_t base = 8u + (uint32_t)w * h * 2u;
  uint8_t tag[8];
  if (file.size() < base + 12 || !file.seek(base) || !readBytes(file, tag, 8)) return false;
  if (memcmp(tag,"SCRO",4) == 0) return readScroll(file,tag);
  if (memcmp(tag,"WAVE",4) == 0) return readWave(file,tag);
  if (memcmp(tag,"ANIM",4) != 0) return false;
  uint8_t head[4];
  if (!readBytes(file, head, 4)) return false;
  const int nSprites = head[0], nStars = head[1];
  if (nSprites > MAX_SPRITES || nStars > MAX_ANIM_STARS) return false;
  if (head[2]) {
    uint8_t m[16];
    if (!readBytes(file, m, 16)) return false;
    meteor.present = true;
    meteor.active = false;
    meteor.x0 = le16s(m); meteor.y0 = le16s(m + 2); meteor.x1 = le16s(m + 4); meteor.y1 = le16s(m + 6);
    meteor.periodMs = le16u(m + 8); meteor.head = le16u(m + 10); meteor.tail = le16u(m + 12);
    meteor.length = m[14] < 2 || m[14] > 24 ? 12 : m[14];
    meteor.speed = m[15] < 1 || m[15] > 12 ? 4 : m[15];
    meteor.lw = 0;
    meteor.next = animationClock.time(millis()) + 2500UL; // first one soon after the page appears
  }
  for (int i = 0; i < nStars; i++) {
    uint8_t e[10];
    if (!readBytes(file, e, 10)) { freeAnim(); return false; }
    AnimStar &st = animStars[animStarCount++];
    st.x = le16s(e); st.y = le16s(e + 2); st.base = le16u(e + 4); st.hi = le16u(e + 6); st.lo = le16u(e + 8);
    st.step = 0;
  }
  size_t biggest = 96 * 48;                          // room for the shooting star
  for (int i = 0; i < nSprites; i++) {
    uint8_t hdr[12];
    if (!readBytes(file, hdr, 12)) { freeAnim(); return false; }
    AnimSprite &s = sprites[spriteCount];
    s.pixels = nullptr;
    s.w = le16u(hdr); s.h = le16u(hdr + 2); s.x = le16s(hdr + 4); s.y = le16s(hdr + 6);
    s.frames = hdr[8]; s.steps = hdr[9]; s.stepMs = le16u(hdr + 10);
    if (s.w < 1 || s.w > 96 || s.h < 1 || s.h > 96 || s.frames < 1 || s.frames > 8 || s.steps < 1 ||
        s.steps > MAX_STEPS || s.stepMs < 40) { freeAnim(); return false; }
    int minDx = 0, maxDx = 0, minDy = 0, maxDy = 0;
    for (int k = 0; k < s.steps; k++) {
      uint8_t st[3];
      if (!readBytes(file, st, 3)) { freeAnim(); return false; }
      s.stepFrame[k] = st[0]; s.stepDx[k] = (int8_t)st[1]; s.stepDy[k] = (int8_t)st[2];
      minDx = min(minDx, (int)s.stepDx[k]); maxDx = max(maxDx, (int)s.stepDx[k]);
      minDy = min(minDy, (int)s.stepDy[k]); maxDy = max(maxDy, (int)s.stepDy[k]);
    }
    const size_t count = (size_t)s.frames * s.w * s.h;
    s.pixels = (uint16_t *)malloc(count * 2);
    if (!s.pixels) { freeAnim(); return false; }
    spriteCount++;                                   // counted before it is filled so freeAnim() releases it
    if (!readBytes(file, s.pixels, count * 2)) { freeAnim(); return false; }
    // the box this sprite can ever cover, kept inside the screen
    int bx = s.x + minDx, by = s.y + minDy;
    int bw = s.w * ANIM_SCALE + (maxDx - minDx), bh = s.h * ANIM_SCALE + (maxDy - minDy);
    if (bx < 0) { bw += bx; bx = 0; }
    if (by < 0) { bh += by; by = 0; }
    if (bx + bw > 320) bw = 320 - bx;
    if (by + bh > 240) bh = 240 - by;
    if (bw <= 0 || bh <= 0) { freeAnim(); return false; }
    s.bx = bx; s.by = by; s.bw = bw; s.bh = bh;
    s.lastStep = -1;
    biggest = max(biggest, (size_t)bw * bh);
  }
  region = (uint16_t *)malloc(biggest * 2);
  if (!region) { freeAnim(); return false; }
  regionPixels = biggest;
  animating = spriteCount > 0 || animStarCount > 0 || meteor.present;
  return animating;
}

// One shooting star: a bright head with a tail that fades into the sky, drawn on the 2x2 grid.
static void meteorTick(unsigned long now, File &file) {
  if (!meteor.present) return;
  if (!meteor.active) {
    if ((long)(now - meteor.next) < 0) return;
    meteor.active = true;
    meteor.hx = meteor.x0 + (int)random(max(1, (int)meteor.x1 - meteor.x0 + 1));
    meteor.hy = meteor.y0 + (int)random(max(1, (int)meteor.y1 - meteor.y0 + 1));
    meteor.ticks = 0;
    meteor.lw = 0;
  }
  meteor.hx += meteor.speed;
  meteor.hy += meteor.speed / 2;
  meteor.ticks++;
  const bool done = meteor.ticks > 60 || meteor.hx > 330 || meteor.hy > meteor.y1 + 36;   // gone before the skyline
  const int len = meteor.length;
  int x0 = min((int)meteor.hx - len * 2, (int)meteor.hx) - 2, y0 = min((int)meteor.hy - len, (int)meteor.hy) - 2;
  int x1 = (int)meteor.hx + 4, y1 = (int)meteor.hy + 4;
  int nx0 = x0, ny0 = y0, nx1 = x1, ny1 = y1;       // the box of this tick, then widened to the previous one
  if (meteor.lw > 0) {
    x0 = min(x0, (int)meteor.lx); y0 = min(y0, (int)meteor.ly);
    x1 = max(x1, (int)meteor.lx + meteor.lw); y1 = max(y1, (int)meteor.ly + meteor.lh);
  }
  x0 = max(x0, 0); y0 = max(y0, 0); x1 = min(x1, 320); y1 = min(y1, 240);
  nx0 = max(nx0, 0); ny0 = max(ny0, 0); nx1 = min(nx1, 320); ny1 = min(ny1, 240);
  const int rw = x1 - x0, rh = y1 - y0;
  if (rw <= 0 || rh <= 0 || (size_t)rw * rh > regionPixels || !readRect(file, x0, y0, rw, rh, region)) {
    meteor.active = false;
    meteor.lw = 0;
    meteor.next = now + meteor.periodMs;
    return;
  }
  if (!done) {
    for (int i = len; i >= 0; i--) {                 // tail first, so the head ends on top
      const int px = ((int)meteor.hx - i * 2) & ~1, py = ((int)meteor.hy - i) & ~1;
      if (px < x0 || py < y0 || px + 2 > x1 || py + 2 > y1) continue;
      for (int dy = 0; dy < 2; dy++) {
        for (int dx = 0; dx < 2; dx++) {
          uint16_t &cell = region[(size_t)(py + dy - y0) * rw + (px + dx - x0)];
          cell = i == 0 ? meteor.head : blend565(cell, meteor.tail, (uint8_t)(255 - (i * 150) / (len + 1)));
        }
      }
    }
  }
  pushRegion(x0, y0, rw, rh, region);
  if (done) {
    meteor.active = false;
    meteor.lw = 0;
    meteor.next = now + (unsigned long)meteor.periodMs * (70 + random(61)) / 100UL;
  } else {
    meteor.lx = nx0; meteor.ly = ny0; meteor.lw = nx1 - nx0; meteor.lh = ny1 - ny0;
  }
}

// Aim for an even 50 fps when a small wave region lets the board keep up.
// The independent animation clock keeps the wave duration and speed setting.
static bool beachFrameDue(unsigned long realNow) {
  return !ocean.active || ocean.version != 3 || !waveFrames || realNow-wavePreviousFrameMs >= 20UL;
}

static void animTick(unsigned long realNow) {
  static unsigned long lastTick = 0, lastStars = 0;
  if (!animating) return;
  const uint32_t now = animationClock.time(realNow);
  if (scrolling.active) {
    const int frameMs=scrolling.version >= 2 ? SCROLL_SMOOTH_MS : SCROLL_FRAME_MS;
    const unsigned long step=(now-scrolling.started)/frameMs;
    if (step != scrolling.lastStep) {
      drawScroll(step);
      scrolling.lastStep=step;
    }
    return;
  }
  // WAVE3 follows the animation clock directly; an independent throttle
  // would drift against it and delay intermediate poses.
  if (!(ocean.active && ocean.version == 3) && realNow - lastTick < (ocean.active ? 20UL : 40UL)) return;
  lastTick = realNow;
  if (ocean.active) {
    // WAVE3 keeps a 3.2 s water loop and a 6.4 s boat loop, with water
    // interpolated at the timestamp of each actual hardware frame.
    const unsigned long elapsed = now-ocean.started;
    const int step = ocean.version == 3
      ? (elapsed%BEACH_LOOP_MS)*(BEACH_FRAMES*BEACH_SUBSTEPS)/BEACH_LOOP_MS
      : (elapsed/WAVE_MS)%WAVE_STEPS;
    const int boatStep = ((now-ocean.started)/WAVE_MS)%WAVE_STEPS;
    if (step != ocean.lastStep) {
      if (!oceanFile) oceanFile = LittleFS.open(pagePath(page),"r");
      if (oceanFile) {
        if (ocean.version >= 2 && !ocean.cachedRows &&
            (waveCacheStatus == 1 || waveCacheStatus == 2) &&
            millis()-waveCacheAttemptAt >= 5000UL) cacheBeach(oceanFile);
        drawWave(step,boatStep,oceanFile);
        ocean.lastStep = step;
      }
    }
    return;
  }
  bool spriteDue = false;
  for (int i = 0; i < spriteCount; i++) {
    if ((int)((now / sprites[i].stepMs) % sprites[i].steps) != sprites[i].lastStep) spriteDue = true;
  }
  const bool meteorDue = meteor.present && (meteor.active || (long)(now - meteor.next) >= 0);
  if (spriteDue || meteorDue) {
    File file = LittleFS.open(pagePath(page), "r");
    if (file) {
      for (int i = 0; i < spriteCount; i++) {
        const int step = (int)((now / sprites[i].stepMs) % sprites[i].steps);
        if (step != sprites[i].lastStep) {
          sprites[i].lastStep = step;
          drawSpriteStep(sprites[i], step, file);
        }
      }
      meteorTick(now, file);
      file.close();
    }
  }
  if (animStarCount > 0 && now - lastStars >= 160) {
    lastStars = now;
    for (int k = 0; k < 2; k++) {
      AnimStar &st = animStars[random(animStarCount)];
      st.step = (st.step + 1) & 3;
      const uint16_t colour = st.step == 1 ? st.hi : (st.step == 3 ? st.lo : st.base);
      tft.fillRect(st.x, st.y, 2, 2, fixColor(colour));
    }
  }
}

static bool drawFrame(const String &path) {
  File file = LittleFS.open(path, "r");
  if (!file) return false;
  uint16_t w, h;
  if (!frameHeader(file, w, h)) { file.close(); return false; }
  int x0 = (tft.width() - w) / 2, y0 = (tft.height() - h) / 2;
  if (w < tft.width() || h < tft.height()) tft.fillScreen(TFT_BLACK);
  static uint16_t band[320 * BAND_ROWS];
  for (int y = 0; y < h; y += BAND_ROWS) {
    int rows = min(BAND_ROWS, h - y);
    size_t bytes = (size_t)w * rows * 2;
    if (file.read((uint8_t *)band, bytes) != bytes) break;
    if (swapRedBlue || swapBytes) {
      for (size_t i = 0; i < (size_t)w * rows; i++) {
        uint16_t p = band[i];
        if (swapBytes) p = (p >> 8) | (p << 8);
        if (swapRedBlue) p = ((p & 0xF800) >> 11) | (p & 0x07E0) | ((p & 0x001F) << 11);
        band[i] = p;
      }
    }
    tft.pushImage(x0, y0 + y, w, rows, band);
  }
  readStars(file, w, h);
  if (x0 == 0 && y0 == 0 && readAnim(file, w, h)) {
    // When quota text refreshes, resume the same camera position instead of
    // restarting the level at its first frame.
    if (scrolling.active && scrolling.lastStep) drawScroll(scrolling.lastStep);
    for (int i = 0; i < spriteCount; i++) {          // the first pose, so the page is complete at once
      sprites[i].lastStep = 0;
      drawSpriteStep(sprites[i], 0, file);
    }
  }
  file.close();
  animateStars = starCount > 0 && x0 == 0 && y0 == 0;   // full-screen pages only
  return true;
}

// The page dots are repainted with each scrolling frame. Cache the presence
// mask until storage or its configured capacity changes, instead of reopening
// all page files several times per frame.
static uint8_t indicatorPageMask = 0;
static bool indicatorMaskValid = false;
static int storedPages() {
  if (!indicatorMaskValid) {
    indicatorPageMask = 0;
    for (int n = 0; n < activePages; n++)
      if (LittleFS.exists(pagePath(n))) indicatorPageMask |= (1u << n);
    indicatorMaskValid = true;
  }
  int count = 0;
  for (int n = 0; n < activePages; n++) if (indicatorPageMask & (1u << n)) count++;
  return count;
}

// A quiet page marker: small neutral greys (never white), so it does not compete with the page.
static const uint16_t DOT_ACTIVE = 0x6B6D;   // about RGB(107,109,107)
static const uint16_t DOT_IDLE = 0x2965;     // about RGB(40,44,40)

static void drawRotationIndicator() {
  if (showingInfo || stale) return;
  // Bottom-left 29x9px; dim neutral ink, outside quota text and page dots.
  const int x = 4, y = tft.height()-10;
  const uint16_t ink = 0x7BEF, dim = 0x3186;
  tft.fillRect(x,y,29,9,TFT_BLACK);
  if (!rotationClock.mode) {
    tft.fillRect(x+2,y+2,1,5,dim); tft.fillRect(x+5,y+2,1,5,dim);
  } else {
    tft.drawCircle(x+4,y+4,3,dim);
    unsigned progress = rotationClock.progress(millis());
    for (int yy=-2; yy<=2; ++yy) for (int xx=-2; xx<=2; ++xx)
      if (xx*xx+yy*yy<=5 && (2-yy)*20 < (int)progress)
        tft.drawPixel(x+4+xx,y+4+yy,ink);
    if (rotationClock.mode==30) tft.drawLine(x+4,y+1,x+4,y+7,ink);
    tft.setTextColor(dim,TFT_BLACK); tft.setTextDatum(TL_DATUM);
    tft.drawString(rotationClock.mode==30 ? "30m" : "1h", x+10,y,1);
    if (!rotationClock.synced) tft.drawPixel(x+28,y+1,ink);
  }
}

static void saveSelection() {
  if (page != savedPage) { prefs.putInt("page", page); savedPage = page; }
}

static void restoreSelection() {
  page = prefs.getInt("page", 0);
  if (page < 0 || page >= activePages) page = 0;
  savedPage = page;
  rotationClock.setMode(prefs.getInt("cycle", 0), millis());
}

static void drawIndicator() {
  drawRotationIndicator();
  int count = storedPages();
  if (count < 2) return;
  int x = tft.width() - 8 - (count - 1) * 8;
  for (int n = 0, drawn = 0; n < activePages; n++) {
    if (!(indicatorPageMask & (1u << n))) continue;
    tft.fillCircle(x + drawn * 8, tft.height() - 5, 2, (n == page) ? DOT_ACTIVE : DOT_IDLE);
    drawn++;
  }
}

static void drawStale() {
  unsigned long minutes = haveBeat ? (millis() - lastBeat) / 60000UL : 0;
  message("NO DATA", haveBeat ? ("Last PC update: " + String(minutes) + " min ago") : "Waiting for the PC",
          "Outdated readings are hidden");
}

static void drawInfo() {
  if (paired()) message("AI Desk Display", "http://" + WiFi.localIP().toString(), "Paired with the PC");
  else message("AI Desk Display", "http://" + WiFi.localIP().toString(), "Waiting for PC pairing");
  tft.drawString(String(FIRMWARE), tft.width() / 2, 190, 2);
  tft.drawString("Tap: back | Hold " + String(connectHoldSeconds) + " s: connect", tft.width() / 2, 215, 2);
}

static void drawPage() {
  animationClock.setSpeed(millis(), pageSpeeds[page]);
  animateStars = false;
  freeAnim();
  if (showingInfo) { drawInfo(); return; }
  if (stale) { drawStale(); return; }
  if (!drawFrame(pagePath(page))) {
    message("Page " + String(page + 1) + " missing", "Waiting for the PC");
    return;
  }
  drawIndicator();
}

static int nextStoredPage(int from) {
  for (int step = 1; step <= activePages; step++) {
    int n = (from + step) % activePages;
    if (LittleFS.exists(pagePath(n))) return n;
  }
  return from;
}

static bool authorized() { return paired() && server.hasHeader("X-Token") && server.header("X-Token") == token; }

static void beat() {
  bool first = !haveBeat;
  haveBeat = true;
  lastBeat = millis();
  if (silentRestarts) { silentRestarts = 0; prefs.putInt("srest", 0); }
  if (first) {             // the PC found us: leave the address screen and show the data
    showingInfo = false;
    stale = false;
    if (!LittleFS.exists(pagePath(page))) page = nextStoredPage(page);
    saveSelection();
    drawPage();
  } else if (stale) {
    stale = false;
    drawPage();
  }
}

static void handleInfo() {
  String speeds = "[";
  for (int n=0; n<PAGES; ++n) { if (n) speeds += ","; speeds += String(pageSpeeds[n]); }
  speeds += "]";
  String body = "{\"model\":\"tokentv-board\",\"fw\":\"" + String(FIRMWARE) + "\",\"pages\":" + String(PAGES) +
                ",\"w\":" + String(tft.width()) + ",\"h\":" + String(tft.height()) + ",\"max_bytes\":" +
                String(MAX_PAGE_BYTES) + ",\"format\":\"TVF1\",\"stars\":true,\"paired\":" +
                String(paired() ? "true" : "false") + ",\"up\":" + String(millis() / 1000UL) +
                ",\"rst\":" + String((int)esp_reset_reason()) + ",\"taps\":" + String(tapCount) +
                ",\"longs\":" + String(longCount) + ",\"irq\":" + String(digitalRead(TOUCH_IRQ_PIN)) + ",\"rssi\":" + String(WiFi.RSSI()) + ",\"silent\":" + String(haveBeat ? (long)((millis() - lastBeat) / 1000UL) : -1L) +
                ",\"renews\":" + String(linkRenewals) + ",\"srest\":" + String(silentRestarts) +
                ",\"page\":" + String(page + 1) + ",\"info\":" + String(showingInfo ? 1 : 0) +
                ",\"active\":" + String(activePages) + ",\"anim\":1,\"anim_frames\":8,\"waves\":3,\"scroll\":4,\"scroll_us\":" +
                String(scrollLastUs) + ",\"scroll_max_us\":" + String(scrollMaxUs) + ",\"scroll_frames\":" +
                String(scrollFrames) + ",\"wave_us\":" +
                String(waveLastUs) + ",\"wave_max_us\":" + String(waveMaxUs) + ",\"wave_frames\":" + String(waveFrames) +
                ",\"wave_cache_rows\":" + String(ocean.cachedRows) + ",\"wave_film_stream\":" + String(ocean.streamFilm ? 1 : 0) +
                ",\"wave_read_us\":" + String(waveReadUs) +
                ",\"wave_cache_status\":" + String(waveCacheStatus) + ",\"wave_cache_free\":" + String(waveCacheFree) +
                ",\"wave_cache_largest\":" + String(waveCacheLargest) +
                ",\"wave_compose_us\":" + String(waveComposeUs) + ",\"wave_push_us\":" + String(wavePushUs) +
                ",\"wave_boat_us\":" + String(waveBoatUs) + ",\"wave_loop_us\":" + String(waveLoopUs) +
                ",\"wave_indicator_us\":" + String(waveIndicatorUs) +
                ",\"wave_gap_ms\":" + String(waveGapMs) + ",\"wave_max_gap_ms\":" + String(waveMaxGapMs) +
                ",\"wave_slow_frames\":" + String(waveSlowFrames) +
                ",\"anim_active\":" + String(animating ? "true" : "false") + ",\"free_heap\":" + String(ESP.getFreeHeap()) +
                ",\"rotation_minutes\":" + String(rotationClock.mode) + ",\"board_controls\":1,\"animation_speed\":" +
                String(animationClock.speed()) + ",\"per_screen_speed\":true,\"animation_speeds\":" + speeds +
                ",\"touch_controls\":1,\"mode_hold_seconds\":" + String(modeHoldSeconds) +
                ",\"connect_hold_seconds\":" + String(connectHoldSeconds) +
                ",\"selection_memory\":true,\"clock_synced\":" + String(rotationClock.synced ? "true" : "false") + "}";
  server.send(200, "application/json", body);
}

// POST /ping answers one character per page: 1 if it is stored. The PC resends the missing ones,
// so a board that was reflashed, formatted or replaced refills itself without anyone restarting the PC.
static void handlePing() {
  if (!authorized()) { server.send(401, "text/plain", "token"); return; }
  if (server.hasArg("clock")) {
    String value = server.arg("clock");
    bool valid = value.length() == 10;
    for (size_t i=0; valid && i<value.length(); ++i) valid = value[i]>='0' && value[i]<='9';
    if (!valid) { server.send(400,"text/plain","clock"); return; }
    uint64_t seconds = strtoull(value.c_str(), nullptr, 10);
    if (seconds < 1700000000ULL || seconds > 4102444800ULL) { server.send(400,"text/plain","clock"); return; }
    rotationClock.sync(seconds, millis());
  }
  String stored;
  for (int n = 0; n < PAGES; n++) stored += LittleFS.exists(pagePath(n)) ? '1' : '0';
  beat();
  server.send(200, "text/plain", stored);
}

static void applyDisplayOptions() {
  tft.setRotation(rotation);
  tft.invertDisplay(invertColors);
}

// POST /config?rotation=1|3&invert=0|1&swaprb=0|1&swapbytes=0|1 (token).
// Stored, so a panel that differs from the usual one needs no reflashing.
static void handleConfig() {
  if (!authorized()) { server.send(401, "text/plain", "token"); return; }
  // Validate both new options before applying either; invalid strings must not become zero.
  if (server.hasArg("cycle")) {
    String v = server.arg("cycle");
    if (v != "0" && v != "30" && v != "60") { server.send(400, "text/plain", "cycle"); return; }
  }
  if (server.hasArg("speed")) {
    String v = server.arg("speed");
    if (v != "75" && v != "100" && v != "125") { server.send(400, "text/plain", "speed"); return; }
  }
  if (server.hasArg("speedpage")) {
    String v = server.arg("speedpage");
    int n = v.toInt();
    if (!server.hasArg("speed") || n < 0 || n >= PAGES || v != String(n)) {
      server.send(400, "text/plain", "speedpage"); return;
    }
  }
  if (server.hasArg("holdmode") || server.hasArg("holdconnect")) {
    if (!server.hasArg("holdmode") || !server.hasArg("holdconnect")) { server.send(400,"text/plain","hold"); return; }
    String mode = server.arg("holdmode"), connect = server.arg("holdconnect");
    int m = mode.toInt(), c = connect.toInt();
    if (mode != String(m) || connect != String(c) || !validTouchSeconds(m,c)) {
      server.send(400,"text/plain","hold"); return;
    }
  }
  if (server.hasArg("cycle")) {
    int mode = server.arg("cycle").toInt();
    rotationClock.setMode(mode, millis());
    prefs.putInt("cycle", mode);
  }
  if (server.hasArg("speed")) {
    int rate = server.arg("speed").toInt();
    int n = server.hasArg("speedpage") ? server.arg("speedpage").toInt() : page;
    pageSpeeds[n] = rate;
    char key[12]; snprintf(key, sizeof(key), "speed%d", n);
    prefs.putInt(key, rate);
    if (n == page) animationClock.setSpeed(millis(), rate);
  }
  if (server.hasArg("holdmode")) {
    modeHoldSeconds = server.arg("holdmode").toInt();
    connectHoldSeconds = server.arg("holdconnect").toInt();
    prefs.putInt("holdmode", modeHoldSeconds);
    prefs.putInt("holdconnect", connectHoldSeconds);
  }
  if (server.hasArg("rotation")) {
    int value = server.arg("rotation").toInt();
    if (value != 1 && value != 3) { server.send(400, "text/plain", "rotation"); return; }
    rotation = value;
  }
  if (server.hasArg("pages")) {                    // how many of the slots are cycled; a deleted page stays out
    int value = server.arg("pages").toInt();
    if (value < 1 || value > PAGES) { server.send(400, "text/plain", "pages"); return; }
    activePages = value;
    indicatorMaskValid = false;
    prefs.putInt("np", activePages);
    if (page >= activePages) { page = 0; saveSelection(); }
  }
  if (server.hasArg("invert")) invertColors = server.arg("invert").toInt() != 0;
  if (server.hasArg("swaprb")) swapRedBlue = server.arg("swaprb").toInt() != 0;
  if (server.hasArg("swapbytes")) swapBytes = server.arg("swapbytes").toInt() != 0;
  prefs.putInt("rot", rotation);
  prefs.putBool("inv", invertColors);
  prefs.putBool("swap", swapRedBlue);
  prefs.putBool("bswap", swapBytes);
  applyDisplayOptions();
  drawPage();
  server.send(200, "text/plain", "OK");
}

// POST /pair?token=<16 hex>. An unpaired board is claimed by whoever asks first; a paired one
// only changes its token for a caller that already knows the current one.
static void handlePair() {
  String candidate = server.arg("token");
  bool valid = candidate.length() == 16;
  for (size_t i = 0; valid && i < candidate.length(); i++) {
    char c = candidate[i];
    valid = (c >= '0' && c <= '9') || (c >= 'a' && c <= 'f');
  }
  if (!valid) { server.send(400, "text/plain", "token"); return; }
  if (paired() && !authorized()) { server.send(401, "text/plain", "token"); return; }
  token = candidate;
  prefs.putString("token", token);
  if (showingInfo) drawPage();
  server.send(200, "text/plain", "OK");
}

static void handleUpdateDone() {
  bool allowed = updateAllowed, ok = updateOk;
  updateAllowed = false;
  updateOk = false;
  if (!allowed) { server.send(401, "text/plain", authorized() ? "touch" : "token"); drawPage(); return; }
  if (!ok) { server.send(400, "text/plain", "bad firmware"); drawPage(); return; }
  server.send(200, "text/plain", "OK");
  delay(500);
  ESP.restart();
}

// Token AND the address screen on display (a long touch on the board): code is not changed by
// anyone who only shares the network.
static void handleUpdateUpload() {
  HTTPUpload &upload = server.upload();
  if (upload.status == UPLOAD_FILE_START) {
    updateOk = false;
    updateStarted = false;
    updateAllowed = authorized() && showingInfo;
    if (!updateAllowed) return;
    message("Updating...", "Keep the display powered on");
    updateStarted = Update.begin(UPDATE_SIZE_UNKNOWN);
  } else if (upload.status == UPLOAD_FILE_WRITE) {
    if (updateStarted && Update.write(upload.buf, upload.currentSize) != upload.currentSize) {
      Update.abort();
      updateStarted = false;
    }
  } else if (upload.status == UPLOAD_FILE_END) {
    if (updateStarted) {
      updateOk = Update.end(true);
      updateStarted = false;
    }
  } else if (upload.status == UPLOAD_FILE_ABORTED) {
    if (updateStarted) Update.abort();
    updateStarted = false;
  }
}

static void handleShow() {
  if (!authorized()) { server.send(401, "text/plain", "token"); return; }
  int n = server.arg("n").toInt();
  if (n < 0 || n >= activePages || !LittleFS.exists(pagePath(n))) { server.send(404, "text/plain", "page"); return; }
  page = n;
  saveSelection();
  showingInfo = false;
  drawPage();
  server.send(200, "text/plain", "OK");
}

static void handleTouch(bool pressed, uint32_t now) {
  static uint32_t lastTap = 0;
  if (pressed && !touchHeld) { touchHeld=true; heldSince=now; }
  if (!pressed && touchHeld) {
    touchHeld=false;
    Gesture action = gesture(now-heldSince, modeHoldSeconds, connectHoldSeconds);
    if (action == Gesture::Connect) {
      ++longCount; showingInfo=true; confirmationUntil=0; drawPage();
    } else if (action == Gesture::Mode) {
      int mode=rotationClock.mode==0 ? 30 : rotationClock.mode==30 ? 60 : 0;
      rotationClock.setMode(mode,now); prefs.putInt("cycle",mode);
      showingInfo=false; confirmationUntil=now+2000; drawPage();
    } else if (action == Gesture::Page && now-lastTap>TAP_DEBOUNCE_MS) {
      lastTap=now; ++tapCount;
      if (showingInfo) showingInfo=false; else page=nextStoredPage(page);
      saveSelection(); confirmationUntil=0; drawPage();
    }
  }
}

// Shared by the main loop and bounded transfer chunks: do not recurse into HTTP.
static void serviceTouch(uint32_t now) {
  static uint32_t lastPoll = 0;
  if (updateStarted || now-lastPoll < 10) return;
  lastPoll = now;
  handleTouch(touch.touched(), now);
}

static void serviceRotation(uint32_t now) {
  if (rotationClock.due(now, !touchHeld && !showingInfo && !stale && haveBeat && now-lastBeat<=STALE_MS && !updateStarted)) {
    page=nextStoredPage(page); saveSelection(); drawPage();
  }
}

// ---- cooperative page transfers ---------------------------------------------------------
// WebServer handles a whole request synchronously. Keep drawing between chunks;
// never recurse into handleClient or a firmware update here. Touch handlers only
// change local selection/drawing; the current transfer retains its own file handle.
static void servicePageAnimation() {
  static unsigned long lastResidentTransferFrame = 0, lastTransferIndicator = 0;
  if (updateStarted) return;
  const unsigned long now = millis();
  serviceTouch(now);
  if (showingInfo) return;
  const bool expired = haveBeat ? now - lastBeat > STALE_MS : now > STALE_MS;
  if (expired && !stale) { stale = true; drawPage(); }
  serviceRotation(now);
  if (!stale) {
    const unsigned long before=scrolling.lastStep;
    const int beforeWave=ocean.lastStep;
    const bool resident=scrolling.active || ocean.active;
    // Budget time for networking. Include the draw itself in the interval,
    // and adapt to the board's measured cost.
    // A fast ocean can therefore draw more often without starving transfers.
    const unsigned long waveCostMs=(waveLastUs+999UL)/1000UL;
    const unsigned long minimum=ocean.version == 3 ? 50UL : 140UL;
    const unsigned long interval=ocean.active ? max(minimum, min(500UL, waveCostMs*2UL)) : 100UL;
    if ((!resident || !touchHeld) &&
        (!resident || now-lastResidentTransferFrame >= interval)) {
      animTick(now);
      if ((scrolling.active && scrolling.lastStep != before) ||
          (ocean.active && ocean.lastStep != beforeWave)) {
        lastResidentTransferFrame = now;
      }
    }
    if ((scrolling.active && scrolling.lastStep != before) ||
        (ocean.active && ocean.lastStep != beforeWave)) {
      drawIndicator();
      lastTransferIndicator = now;
    } else if (now-lastTransferIndicator >= 100UL) {
      drawRotationIndicator();
      lastTransferIndicator = now;
    }
  }
}

static void handlePageRead() {
  if (!authorized()) { server.send(401, "text/plain", "token"); return; }
  int n = server.arg("n").toInt();
  if (n < 0 || n >= PAGES || !LittleFS.exists(pagePath(n))) { server.send(404, "text/plain", "page"); return; }
  File file = LittleFS.open(pagePath(n), "r");
  if (!file) { server.send(404, "text/plain", "page"); return; }
  const size_t length = file.size();
  server.setContentLength(length);
  server.send(200, "application/octet-stream", "");
  auto client = server.client();
  uint8_t buffer[1024];
  size_t remaining = length;
  unsigned long progress = millis();
  while (remaining && client.connected()) {
    const size_t count = file.read(buffer, min(remaining, sizeof(buffer)));
    if (!count) { client.stop(); break; }
    size_t offset = 0;
    while (offset < count && client.connected()) {
      servicePageAnimation();
      // WiFiClient::write retries internally and can block for seconds on a slow
      // reader. A nonblocking socket write lets the animation run while waiting.
      const int sent = ::send(client.fd(), buffer + offset, count - offset, MSG_DONTWAIT);
      if (sent > 0) {
        offset += (size_t)sent;
        progress = millis();
      } else if (sent < 0 && errno != EAGAIN && errno != EWOULDBLOCK && errno != EINTR) {
        client.stop();
      }
      if (millis() - progress >= 2000UL) client.stop();
      delay(1);
    }
    remaining -= offset;
  }
  file.close();
}

static void handlePageUploadDone() {
  bool allowed = uploadAllowed, ok = uploadOk;
  uploadAllowed = false;   // flags belong to this request only
  uploadOk = false;
  if (!allowed) { server.send(401, "text/plain", "token"); return; }
  if (!ok) { server.send(400, "text/plain", "bad frame"); return; }
  beat();
  if (uploadPage == page && !showingInfo && !stale) {
    redrawPending = false;
    drawPage();
  }
  server.send(200, "text/plain", "OK");
}

static void handlePageUpload() {
  HTTPUpload &upload = server.upload();
  if (upload.status == UPLOAD_FILE_START) {
    uploadOk = false;
    uploadBytes = 0;
    uploadPage = server.arg("n").toInt();
    uploadAllowed = authorized() && uploadPage >= 0 && uploadPage < PAGES;
    if (!uploadAllowed) return;
    uploadFile = LittleFS.open("/incoming.tmp", "w");
  } else if (upload.status == UPLOAD_FILE_WRITE) {
    if (uploadAllowed && uploadFile) {
      servicePageAnimation();
      uploadBytes += upload.currentSize;
      if (uploadBytes <= MAX_PAGE_BYTES) uploadFile.write(upload.buf, upload.currentSize);
      servicePageAnimation();
    }
  } else if (upload.status == UPLOAD_FILE_END) {
    if (uploadAllowed && uploadFile) {
      uploadFile.close();
      // Only a well-formed frame replaces the stored page; anything else is dropped.
      File check = LittleFS.open("/incoming.tmp", "r");
      bool valid = false;
      if (check) {
        uint16_t w, h;
        valid = uploadBytes <= MAX_PAGE_BYTES && frameHeader(check, w, h);
        check.close();
      }
      if (valid) {
        // A resident beach keeps its source file open for smooth animation.
        // Release it before replacing that page, then draw the new one below.
        if (uploadPage == page && oceanFile) oceanFile.close();
        LittleFS.remove(pagePath(uploadPage));
        uploadOk = LittleFS.rename("/incoming.tmp", pagePath(uploadPage));
        indicatorMaskValid = false;
        if (uploadOk && uploadPage == page) redrawPending = true;
      } else {
        LittleFS.remove("/incoming.tmp");
      }
    }
  } else if (upload.status == UPLOAD_FILE_ABORTED) {
    if (uploadFile) uploadFile.close();
    LittleFS.remove("/incoming.tmp");
    uploadOk = false;
  }
}

static void onPortal(WiFiManager *) {
  message("Wi-Fi setup", "Join TokenTV-Display on your phone", "Then choose your home network");
}

void setup() {
  Serial.begin(115200);
  prefs.begin("tokentv", false);
  silentRestarts = prefs.getInt("srest", 0);
  activePages = prefs.getInt("np", PAGES);
  if (activePages < 1 || activePages > PAGES) activePages = PAGES;
  restoreSelection();
  int oldSpeed = prefs.getInt("speed", 100);
  if (!validAnimationSpeed(oldSpeed)) oldSpeed = 100;
  for (int n=0; n<PAGES; ++n) {
    char key[12]; snprintf(key, sizeof(key), "speed%d", n);
    int speed = prefs.getInt(key, oldSpeed);
    pageSpeeds[n] = validAnimationSpeed(speed) ? speed : 100;
  }
  animationClock.setSpeed(millis(), pageSpeeds[page]);
  int savedModeHold = prefs.getInt("holdmode", 2), savedConnectHold = prefs.getInt("holdconnect", 5);
  if (validTouchSeconds(savedModeHold, savedConnectHold)) {
    modeHoldSeconds = savedModeHold; connectHoldSeconds = savedConnectHold;
  }
  rotation = prefs.getInt("rot", 1);
  invertColors = prefs.getBool("inv", TOKENTV_INVERT_DEFAULT);
  swapRedBlue = prefs.getBool("swap", false);
  swapBytes = prefs.getBool("bswap", false);
  tft.init();
  applyDisplayOptions();   // landscape 320x240
  tft.setSwapBytes(true);  // pushImage expects natural (little-endian) RGB565 words
  tft.fillScreen(TFT_BLACK);
  const unsigned long splashStart = millis();
  drawSplash();
  splashStatus("Starting up...");

  // The touch controller sits on its own pins; pin the standard bus there first.
  // (The library's own SPI.begin() is then a no-op.) The display uses another bus.
  SPI.begin(TOUCH_SPI_CLK, TOUCH_SPI_MISO, TOUCH_SPI_MOSI, TOUCH_CS_PIN);
  pinMode(TOUCH_IRQ_PIN, INPUT);   // only observed (/info), no longer what wakes the reads
  touch.begin();
  touch.setRotation(1);

  if (!LittleFS.begin(true)) message("Storage error", "Could not mount LittleFS");
  LittleFS.remove("/incoming.tmp");

  token = prefs.getString("token", "");   // empty until the PC claims the board
  if (token.length() != 16) token = "";

  splashStatus("Connecting to Wi-Fi...");
  WiFiManager manager;
  manager.setAPCallback(onPortal);
  manager.setConnectTimeout(30);
  if (!manager.autoConnect("TokenTV-Display")) ESP.restart();
  // Always on mains: no modem sleep. With it some routers stop delivering unicast frames to an idle ESP32, which then
  // answers ARP yet neither ping nor HTTP ("associated but deaf", seen 2026-10-13 on this board).
  WiFi.setSleep(false);
  WiFi.setAutoReconnect(true);

  while (millis() - splashStart < 2200) delay(20);   // let the splash be seen, however fast the wifi was
  const char *headers[] = {"X-Token"};
  server.collectHeaders(headers, 1);
  server.on("/info", HTTP_GET, handleInfo);
  server.on("/ping", HTTP_POST, handlePing);
  server.on("/show", HTTP_POST, handleShow);
  server.on("/config", HTTP_POST, handleConfig);
  server.on("/pair", HTTP_POST, handlePair);
  server.on("/update", HTTP_POST, handleUpdateDone, handleUpdateUpload);
  server.on("/page", HTTP_GET, handlePageRead);
  server.on("/page", HTTP_POST, handlePageUploadDone, handlePageUpload);
  server.begin();

  showingInfo = true;   // first screen: where to point the PC at; the first heartbeat leaves it
  drawPage();
}

void loop() {
  server.handleClient();

  const unsigned long loopBegan = micros();
  static uint32_t lastCheck = 0;
  uint32_t now = millis();
  serviceTouch(now);
  serviceRotation(now);

  if (redrawPending) {                     // a fresh copy of the page being shown arrived: show it, not the old one
    redrawPending = false;
    if (!showingInfo && !stale && !updateStarted) drawPage();
  }
  bool residentFrame=false;
  if (!showingInfo && !stale) {
    const unsigned long before=scrolling.lastStep;
    const int beforeWave=ocean.lastStep;
    if ((!(scrolling.active || ocean.active) || !touchHeld) && beachFrameDue(now)) animTick(now);
    residentFrame=(scrolling.active && scrolling.lastStep != before) ||
                  (ocean.active && ocean.lastStep != beforeWave);
    if (residentFrame) {
      const unsigned long indicatorBegan = micros();
      drawIndicator();
      if (ocean.active) {
        waveIndicatorUs = micros()-indicatorBegan;
        waveLoopUs = micros()-loopBegan;
      }
    }
  }

  static unsigned long lastTwinkle = 0;
  if (animateStars && starCount > 0 && !showingInfo && !stale && now - lastTwinkle >= 50) {
    lastTwinkle = now;
    for (int k = 0; k < 6; k++) {         // six stars move a step each tick, so every star changes about once a
      Star &st = stars[random(starCount)];   // second: rest, a white spark with its cross, a glow, then nearly out
      st.step = (st.step + 1) % 6;
      paintStar(st, st.step >= 1 && st.step <= 3);   // steps 1-3 touch the cross (3 gives the page back)
    }
  }

  static uint32_t lastOverlay = 0;
  static bool overlayWasVisible = false;
  Gesture heldAction = touchHeld ? gesture(now-heldSince, modeHoldSeconds, connectHoldSeconds) : Gesture::None;
  bool preview = heldAction == Gesture::Mode || heldAction == Gesture::Connect;
  bool confirm = confirmationUntil && (int32_t)(confirmationUntil-now)>0;
  if (overlayWasVisible && !preview && !confirm) { confirmationUntil=0; drawPage(); }
  overlayWasVisible=preview || confirm;
  if (!showingInfo && !stale && (residentFrame || now-lastOverlay>=100)) {
    lastOverlay=now;
    if (!residentFrame) drawRotationIndicator();  // drawIndicator already painted it on a resident frame
    if (preview || confirm) {
      const char *text = preview ? (heldAction == Gesture::Connect ? "Release: connect" : "Release: auto-cycle") :
        rotationClock.mode==30 ? "Auto: every 30 min" : rotationClock.mode==60 ? "Auto: every hour" : "Fixed screen";
      tft.fillRect(74,211,172,18,TFT_BLACK);
      tft.setTextDatum(MC_DATUM); tft.setTextColor(0xAD55,TFT_BLACK);
      tft.drawString(text,160,220,2);
    }
  }

  if (now - lastCheck > 1000) {
    lastCheck = now;
    bool expired = haveBeat ? (now - lastBeat > STALE_MS) : (now > STALE_MS);
    if (expired && !stale && !showingInfo) { stale = true; drawPage(); }
  }
  // The PC beats about once a minute. Three silent minutes may mean the router still shows this board as
  // associated but no longer delivers to it (seen on this board): renew the link, at most every five minutes.
  // After ten silent minutes restart it, at most three times per silence, so a PC that is simply off does not
  // reboot it all night. Judged on the silence itself and not on the screen: after a boot the board sits on its
  // address screen and never becomes "stale", which is exactly when it used to give up.
  static unsigned long lastRenew = 0;
  const unsigned long silent = haveBeat ? now - lastBeat : now;
  if (silent > 180000UL && now - lastRenew > 300000UL) {
    lastRenew = now;
    linkRenewals++;
    WiFi.reconnect();
  }
  if (silent > 600000UL && silentRestarts < 3) {
    prefs.putInt("srest", silentRestarts + 1);
    ESP.restart();
  }
  // Wi-Fi loss uses the same grace period and persisted restart budget above.
  // A separate outage timer used to survive reconnections and bypass the cap.
}
